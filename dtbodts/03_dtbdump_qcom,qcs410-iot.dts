/dts-v1/;

/ {
	compatible = "qcom,qcs410-iot", "qcom,qcs410", "qcom,iot";
	model = "IOT";
	qcom,board-id = <0x20 0x0>;
	qcom,msm-id = <0x196 0x0>;

	__fixups__ {
		L16A = "/fragment@10:target:0";
		L19A = "/fragment@11:target:0";
		L4C = "/fragment@12:target:0";
		L5C = "/fragment@13:target:0";
		pil_camera_mem = "/fragment@8:target:0";
		pil_modem_mem = "/fragment@9:target:0";
		pm6150_charger = "/fragment@7:target:0";
		pm6150_qg = "/fragment@6:target:0";
		pm6150_vadc = "/fragment@0/__overlay__/qcom,smb1390@10/qcom,charge_pump:io-channels:0", "/fragment@7/__overlay__:io-channels:0", "/fragment@7/__overlay__:io-channels:8", "/fragment@7/__overlay__:io-channels:16", "/fragment@7/__overlay__:io-channels:24", "/fragment@7/__overlay__:io-channels:32", "/fragment@7/__overlay__:io-channels:40", "/fragment@7/__overlay__:io-channels:48";
		pm6150l_gpios = "/fragment@1:target:0", "/fragment@2/__overlay__/gpio_keys/vol_up:gpios:0";
		pm6150l_lcdb = "/fragment@4:target:0";
		pm6150l_pwm_1 = "/fragment@5:target:0";
		pm6150l_wled = "/fragment@3:target:0";
		qupv3_se3_i2c = "/fragment@0:target:0";
		qusb_phy0 = "/fragment@7/__overlay__:dpdm-supply:0";
		smb_stat_default = "/fragment@0/__overlay__/qcom,smb1390@10:pinctrl-0:0";
		soc = "/fragment@2:target:0";
		spmi_bus = "/fragment@0/__overlay__/qcom,smb1390@10:interrupt-parent:0";
	};

	__local_fixups__ {

		fragment@0 {

			__overlay__ {

				qcom,smb1390@10 {

					qcom,charge_pump {
						interrupt-parent = <0x0>;
						qcom,pmic-revid = <0x0>;
					};
				};
			};
		};

		fragment@2 {

			__overlay__ {

				gpio_keys {
					pinctrl-0 = <0x0>;
				};
			};
		};

		fragment@6 {

			__overlay__ {
				qcom,battery-data = <0x0>;
			};
		};

		fragment@7 {

			__overlay__ {
				qcom,battery-data = <0x0>;
			};
		};
	};

	__symbols__ {
		irled_pwm = "/fragment@1/__overlay__/irled/irled_pwm_default";
		key_vol_up_default = "/fragment@1/__overlay__/key_vol_up/key_vol_up_default";
		mtp_batterydata = "/fragment@2/__overlay__/qcom,battery-data";
		smb1390 = "/fragment@0/__overlay__/qcom,smb1390@10";
		smb1390_charger = "/fragment@0/__overlay__/qcom,smb1390@10/qcom,charge_pump";
		smb1390_revid = "/fragment@0/__overlay__/qcom,smb1390@10/qcom,revid";
		smb1390_slave = "/fragment@0/__overlay__/qcom,smb1390_slave@18";
		smb1390_slave_charger = "/fragment@0/__overlay__/qcom,smb1390_slave@18/qcom,charge_pump_slave";
	};

	fragment@0 {
		target = <0xffffffff>;

		__overlay__ {
			status = "ok";

			qcom,smb1390@10 {
				#address-cells = <0x1>;
				#interrupt-cells = <0x3>;
				#size-cells = <0x0>;
				compatible = "qcom,i2c-pmic";
				interrupt-controller;
				interrupt-parent = <0xffffffff>;
				interrupt_names = "smb1390";
				interrupts = <0x0 0xc2 0x0 0x8>;
				phandle = <0x2>;
				pinctrl-0 = <0xffffffff>;
				pinctrl-names = "default";
				qcom,periph-map = <0x10>;
				reg = <0x10>;
				status = "ok";

				qcom,charge_pump {
					compatible = "qcom,smb1390-charger-psy";
					interrupt-parent = <0x2>;
					io-channel-names = "cp_die_temp";
					io-channels = <0xffffffff 0xf>;
					phandle = <0x5>;
					qcom,pmic-revid = <0x1>;
					status = "ok";

					qcom,core {
						interrupt-names = "switcher-off-window", "switcher-off-fault", "tsd-fault", "irev-fault", "vph-ov-hard", "vph-ov-soft", "ilim", "temp-alarm";
						interrupts = <0x10 0x0 0x3 0x10 0x1 0x3 0x10 0x2 0x3 0x10 0x3 0x3 0x10 0x4 0x3 0x10 0x5 0x1 0x10 0x6 0x1 0x10 0x7 0x1>;
					};
				};

				qcom,revid {
					compatible = "qcom,qpnp-revid";
					phandle = <0x1>;
					reg = <0x100>;
				};
			};

			qcom,smb1390_slave@18 {
				#address-cells = <0x1>;
				#size-cells = <0x0>;
				compatible = "qcom,i2c-pmic";
				phandle = <0x6>;
				qcom,periph-map = <0x10>;
				reg = <0x18>;
				status = "disabled";

				qcom,charge_pump_slave {
					compatible = "qcom,smb1390-slave";
					phandle = <0x7>;
					status = "disabled";
				};
			};
		};
	};

	fragment@1 {
		target = <0xffffffff>;

		__overlay__ {

			irled {

				irled_pwm_default {
					bias-disable;
					function = "func1";
					output-low;
					phandle = <0x8>;
					pins = "gpio6";
					power-source = <0x0>;
					qcom,drive-strength = <0x2>;
				};
			};

			key_vol_up {

				key_vol_up_default {
					bias-pull-up;
					function = "normal";
					input-enable;
					phandle = <0x3>;
					pins = "gpio2";
					power-source = <0x0>;
				};
			};
		};
	};

	fragment@10 {
		target = <0xffffffff>;

		__overlay__ {
			regulator-max-microvolt = <0x326a40>;
		};
	};

	fragment@11 {
		target = <0xffffffff>;

		__overlay__ {
			regulator-max-microvolt = <0x326a40>;
		};
	};

	fragment@12 {
		target = <0xffffffff>;

		__overlay__ {
			regulator-max-microvolt = <0x2c6f00>;
		};
	};

	fragment@13 {
		target = <0xffffffff>;

		__overlay__ {
			regulator-max-microvolt = <0x2c6f00>;
		};
	};

	fragment@2 {
		target = <0xffffffff>;

		__overlay__ {

			gpio_keys {
				compatible = "gpio-keys";
				label = "gpio-keys";
				pinctrl-0 = <0x3>;
				pinctrl-names = "default";

				vol_up {
					debounce-interval = <0xf>;
					gpio-key,wakeup;
					gpios = <0xffffffff 0x2 0x1>;
					label = "volume_up";
					linux,can-disable;
					linux,code = <0x73>;
					linux,input-type = <0x1>;
				};
			};

			qcom,battery-data {
				phandle = <0x4>;
				qcom,batt-id-range-pct = <0xf>;

				qcom,alium_860_89032_0000_3600mAh {
					qcom,batt-id-kohm = <0x6b>;
					qcom,battery-beta = <0x109a>;
					qcom,battery-therm-kohm = <0x64>;
					qcom,battery-type = "Alium_860_89032_0000_3600mAh_Jun15th2018";
					qcom,fastchg-current-ma = <0x1518>;
					qcom,fg-cc-cv-threshold-uv = <0x423920>;
					qcom,jeita-fcc-ranges = <0x0 0x32 0x2625a0 0x33 0x190 0x5265c0 0x191 0x1c2 0x2625a0>;
					qcom,jeita-fv-ranges = <0x0 0x32 0x40d990 0x33 0x190 0x426030 0x191 0x1c2 0x40d990>;
					qcom,jeita-hard-thresholds = <0x58cd 0x20b8>;
					qcom,jeita-soft-fcc-ua = <0x2625a0 0x2625a0>;
					qcom,jeita-soft-fv-uv = <0x40d990 0x40d990>;
					qcom,jeita-soft-hys-thresholds = <0x4f5e 0x2943>;
					qcom,jeita-soft-thresholds = <0x5314 0x25e3>;
					qcom,max-voltage-uv = <0x426030>;
					qcom,ocv-based-step-chg;
					qcom,qg-batt-profile-ver = <0x64>;
					qcom,step-chg-ranges = <0x36ee80 0x39fbc0 0x5265c0 0x39fbc1 0x419ce0 0x36ee80 0x419ce1 0x426030 0x2625a0>;

					qcom,fcc1-temp-lut {
						qcom,lut-col-legend = <0x0 0xa 0x19 0x28 0x32>;
						qcom,lut-data = <0xd62 0xdbf 0xdfd 0xe1d 0xe2e>;
					};

					qcom,fcc2-temp-lut {
						qcom,lut-col-legend = <0xfffffff6 0x0 0xa 0x19 0x28 0x32>;
						qcom,lut-data = <0xdda 0xdf8 0xe02 0xe04 0xdff 0xdff>;
					};

					qcom,pc-temp-v1-lut {
						qcom,lut-col-legend = <0x0 0xa 0x19 0x28 0x32>;
						qcom,lut-data = <0xa846 0xa903 0xa965 0xa982 0xa987 0xa757 0xa82c 0xa88b 0xa8b2 0xa8bc 0xa671 0xa747 0xa7a8 0xa7d4 0xa7e5 0xa598 0xa65f 0xa6c5 0xa6f2 0xa707 0xa4ca 0xa582 0xa5e5 0xa611 0xa627 0xa3ff 0xa4af 0xa508 0xa531 0xa546 0xa330 0xa3e1 0xa430 0xa452 0xa465 0xa25d 0xa311 0xa35c 0xa377 0xa387 0xa1a0 0xa23e 0xa287 0xa29e 0xa2ad 0xa10a 0xa17a 0xa1b1 0xa1c4 0xa1d2 0xa07e 0xa0e5 0xa0f6 0xa0f5 0xa0fc 0x9fa9 0xa061 0xa067 0xa048 0xa036 0x9e4b 0x9f9a 0x9fd6 0x9fae 0x9f81 0x9cdb 0x9e3d 0x9ee8 0x9ee6 0x9ebf 0x9bed 0x9cd1 0x9d85 0x9dc6 0x9dd7 0x9b4d 0x9bf5 0x9c67 0x9cb4 0x9cf4 0x9ad6 0x9b65 0x9bd6 0x9c18 0x9c4a 0x9a75 0x9af5 0x9b63 0x9baa 0x9bc5 0x9a1f 0x9a9b 0x9ade 0x9b13 0x9b23 0x99c4 0x9a41 0x9a3f 0x9a2d 0x9a41 0x9962 0x99c6 0x998a 0x9943 0x9959 0x98fd 0x992a 0x98b8 0x9892 0x98a0 0x9894 0x9882 0x97f4 0x9800 0x9807 0x982b 0x97c6 0x976f 0x9780 0x9781 0x97cb 0x9713 0x970f 0x970c 0x970c 0x9775 0x9697 0x96b5 0x96a2 0x96a2 0x9724 0x963e 0x965a 0x9642 0x963e 0x96db 0x95fa 0x9603 0x95e9 0x95e1 0x9698 0x95c7 0x95b7 0x9598 0x958b 0x965b 0x959d 0x9571 0x954e 0x953b 0x9627 0x9575 0x9533 0x950c 0x94f4 0x95f8 0x9550 0x94fe 0x94d1 0x94b3 0x95cc 0x952e 0x94cf 0x949b 0x947a 0x95a2 0x9511 0x94a4 0x9465 0x9440 0x9579 0x94f7 0x947f 0x9432 0x9407 0x954f 0x94d6 0x9458 0x93fe 0x93cc 0x9525 0x94b2 0x942f 0x93c6 0x938b 0x94f0 0x9484 0x9402 0x938b 0x9345 0x94a6 0x943e 0x93bf 0x9343 0x92f7 0x944c 0x93da 0x935f 0x92ed 0x92a2 0x93e6 0x936c 0x92f1 0x9288 0x923f 0x936b 0x92f1 0x9276 0x920e 0x91c6 0x92e1 0x926f 0x91f1 0x9188 0x9141 0x9248 0x91ea 0x9165 0x90ff 0x90bc 0x91cf 0x9176 0x9100 0x909b 0x905b 0x9179 0x9129 0x90c1 0x9060 0x9022 0x9159 0x910e 0x90ab 0x904f 0x9011 0x913e 0x90f9 0x909a 0x903f 0x9001 0x911a 0x90de 0x907f 0x9020 0x8fdd 0x90ac 0x9070 0x8ff7 0x8f74 0x8f1a 0x8f68 0x8f1c 0x8e9e 0x8e14 0x8db6 0x8d9d 0x8d55 0x8cd8 0x8c4c 0x8beb 0x8b59 0x8b10 0x8a94 0x8a02 0x899f 0x8849 0x87fb 0x877d 0x86e5 0x867d 0x836c 0x8325 0x82aa 0x8209 0x8197 0x7530 0x7530 0x7530 0x7530 0x7530>;
						qcom,lut-row-legend = <0x2710 0x2648 0x2580 0x24b8 0x23f0 0x2328 0x2260 0x2198 0x20d0 0x2008 0x1f40 0x1e78 0x1db0 0x1ce8 0x1c20 0x1b58 0x1a90 0x19c8 0x1900 0x1838 0x1770 0x16a8 0x15e0 0x1518 0x1450 0x1388 0x12c0 0x11f8 0x1130 0x1068 0xfa0 0xed8 0xe10 0xd48 0xc80 0xbb8 0xaf0 0xa28 0x960 0x898 0x7d0 0x708 0x640 0x578 0x4b0 0x3e8 0x384 0x320 0x2bc 0x258 0x1f4 0x190 0x12c 0xc8 0x64 0x0>;
					};

					qcom,pc-temp-v2-lut {
						qcom,lut-col-legend = <0xfffffff6 0x0 0xa 0x19 0x28 0x32>;
						qcom,lut-data = <0xa98d 0xa97e 0xa974 0xa960 0xa92e 0xa910 0xa7fb 0xa83a 0xa854 0xa856 0xa82f 0xa819 0xa6a3 0xa712 0xa747 0xa757 0xa738 0xa728 0xa594 0xa609 0xa64d 0xa665 0xa64a 0xa63c 0xa4c7 0xa51d 0xa566 0xa581 0xa565 0xa558 0xa3f4 0xa43e 0xa489 0xa4a2 0xa484 0xa478 0xa2af 0xa364 0xa3b3 0xa3c8 0xa3a5 0xa397 0xa162 0xa292 0xa2e4 0xa2f3 0xa2ca 0xa2b9 0xa11a 0xa1c1 0xa210 0xa21b 0xa1ef 0xa1de 0xa14f 0xa0ea 0xa131 0xa139 0xa110 0xa103 0xa17a 0xa03c 0xa071 0xa077 0xa047 0xa035 0xa046 0x9fd6 0x9ff5 0x9ff5 0x9fb3 0x9f87 0x9d6d 0x9f7f 0x9f85 0x9f81 0x9f2b 0x9ee2 0x9b88 0x9eab 0x9ea9 0x9ead 0x9e5e 0x9e1a 0x9a81 0x9c78 0x9cde 0x9d1e 0x9d16 0x9d22 0x99b8 0x9a96 0x9b46 0x9bd5 0x9bfe 0x9c3f 0x9913 0x99e8 0x9a78 0x9b4d 0x9b70 0x9b9c 0x9887 0x9977 0x99df 0x9aeb 0x9b04 0x9b0e 0x97f7 0x98f2 0x9948 0x9a53 0x9a64 0x9a58 0x975c 0x9856 0x98b5 0x9965 0x9971 0x9967 0x96c8 0x97b8 0x9827 0x987f 0x9885 0x9883 0x9649 0x9720 0x9799 0x97d3 0x97d8 0x97d6 0x95d8 0x968d 0x9711 0x9743 0x9748 0x9745 0x957d 0x9608 0x9697 0x96c6 0x96cb 0x96c8 0x9533 0x9591 0x9629 0x9658 0x965c 0x9658 0x94f4 0x952a 0x95c3 0x95f3 0x95f6 0x95f1 0x94bc 0x94d6 0x9565 0x9595 0x9598 0x9592 0x948a 0x9491 0x950e 0x953e 0x9540 0x9538 0x9458 0x9459 0x94bd 0x94f0 0x94ef 0x94e6 0x9429 0x942b 0x9471 0x94aa 0x94a5 0x949b 0x93fa 0x9403 0x942c 0x9467 0x9461 0x9456 0x93cb 0x93dc 0x93ed 0x9426 0x9422 0x9418 0x939a 0x93b7 0x93b6 0x93e7 0x93e7 0x93dd 0x9366 0x9390 0x9384 0x93a6 0x93a1 0x9392 0x9330 0x9367 0x935a 0x9364 0x9348 0x932b 0x92f5 0x933c 0x9330 0x9322 0x92ea 0x92bd 0x92b6 0x9309 0x9301 0x92e2 0x9296 0x925d 0x9274 0x92ce 0x92cf 0x92a2 0x9248 0x9208 0x922d 0x9289 0x9294 0x925e 0x91fe 0x91bc 0x91e4 0x9235 0x924a 0x9214 0x91b6 0x9173 0x919a 0x91d4 0x91f2 0x91c0 0x9166 0x9124 0x9151 0x916d 0x918d 0x9158 0x9101 0x90c0 0x910a 0x9104 0x9119 0x90da 0x9085 0x9045 0x90be 0x90a5 0x90a4 0x9064 0x9011 0x8fd4 0x9066 0x9055 0x9058 0x9026 0x8fde 0x8fa3 0x8ff1 0x9009 0x9027 0x900b 0x8fc1 0x8f87 0x8fa0 0x8fd7 0x9010 0x8ff6 0x8fb0 0x8f76 0x8f3a 0x8f9b 0x8ff2 0x8fd7 0x8f94 0x8f5b 0x8e9d 0x8f3c 0x8fa7 0x8f84 0x8f3f 0x8efc 0x8dbc 0x8e73 0x8ecd 0x8e86 0x8e46 0x8df2 0x8c72 0x8d0b 0x8d41 0x8ce7 0x8ca5 0x8c4f 0x8a95 0x8b0d 0x8b2a 0x8ad3 0x8a9a 0x8a45 0x87f8 0x8865 0x887d 0x881c 0x87ec 0x879d 0x841a 0x8496 0x84d3 0x8488 0x847e 0x8426 0x7eca 0x7f24 0x801b 0x8028 0x7f97 0x7ef0 0x6fcb 0x6e6e 0x6d71 0x6d74 0x6d50 0x6d1a>;
						qcom,lut-row-legend = <0x2710 0x2648 0x2580 0x24b8 0x23f0 0x2328 0x2260 0x2198 0x20d0 0x2008 0x1f40 0x1e78 0x1db0 0x1ce8 0x1c20 0x1b58 0x1a90 0x19c8 0x1900 0x1838 0x1770 0x16a8 0x15e0 0x1518 0x1450 0x1388 0x12c0 0x11f8 0x1130 0x1068 0xfa0 0xed8 0xe10 0xd48 0xc80 0xbb8 0xaf0 0xa28 0x960 0x898 0x7d0 0x708 0x640 0x578 0x4b0 0x3e8 0x384 0x320 0x2bc 0x258 0x1f4 0x190 0x12c 0xc8 0x64 0x0>;
					};

					qcom,pc-temp-y1-lut {
						qcom,lut-col-legend = <0xfffffff6 0x0 0xa 0x19 0x28 0x32>;
						qcom,lut-data = <0x1dae 0x1a6c 0x17b7 0x1540 0x1467 0x143b 0x1db4 0x1a6f 0x17c3 0x153f 0x1466 0x143d 0x1dc0 0x1a74 0x17ca 0x153e 0x1466 0x143e 0x1dcd 0x1a7a 0x17ce 0x153c 0x1466 0x1440 0x1dd8 0x1a7e 0x17d0 0x153b 0x1467 0x1441 0x1ddd 0x1a80 0x17d0 0x153a 0x1467 0x1443 0x1ddc 0x1a80 0x17cc 0x153a 0x1468 0x1443 0x1dda 0x1a80 0x17c6 0x153a 0x146a 0x1444 0x1dd3 0x1a7d 0x17c5 0x153b 0x146c 0x1445 0x1dbc 0x1a76 0x17c8 0x153c 0x146d 0x1446 0x1daa 0x1a70 0x17ca 0x153d 0x146f 0x1448 0x1db3 0x1a6e 0x17c6 0x153d 0x1470 0x1449 0x1dc8 0x1a6f 0x17c0 0x153d 0x1472 0x144b 0x1ddc 0x1a74 0x17c1 0x153e 0x1474 0x144d 0x1df4 0x1a85 0x17d0 0x1545 0x1479 0x1452 0x1e03 0x1a97 0x17db 0x154d 0x147c 0x1454 0x1dfa 0x1aa4 0x17df 0x154f 0x147c 0x1455 0x1de7 0x1aaf 0x17e3 0x1552 0x147d 0x1455 0x1dd8 0x1ab0 0x17e4 0x1554 0x147e 0x1456 0x1dca 0x1aa1 0x17e2 0x1555 0x1480 0x1459 0x1dc3 0x1a95 0x17e2 0x1558 0x1483 0x145c 0x1dd6 0x1a97 0x17ed 0x155c 0x1487 0x1460 0x1df9 0x1a9f 0x17fb 0x1560 0x148b 0x1463 0x1e01 0x1aa5 0x17fd 0x1565 0x148e 0x1467 0x1e00 0x1aa8 0x17f8 0x1569 0x1491 0x146a 0x1e04 0x1aac 0x17f7 0x156d 0x1493 0x146e 0x1e09 0x1ab8 0x1800 0x1571 0x1496 0x1472 0x1e0c 0x1acc 0x180b 0x1576 0x149a 0x1475 0x1e0a 0x1ad7 0x180e 0x157b 0x149d 0x1478 0x1df8 0x1adc 0x1812 0x1581 0x14a0 0x147a 0x1de0 0x1ade 0x1817 0x1586 0x14a3 0x147d 0x1dd9 0x1adb 0x181b 0x158b 0x14a7 0x1480 0x1ddb 0x1ad7 0x181f 0x1590 0x14aa 0x1484 0x1ddd 0x1ad7 0x1820 0x1593 0x14ad 0x1487 0x1de1 0x1ad5 0x1821 0x1596 0x14b0 0x1489 0x1de8 0x1ad3 0x1823 0x1599 0x14b2 0x148b 0x1df7 0x1adf 0x1827 0x159b 0x14b4 0x148c 0x1e0a 0x1aef 0x182c 0x159d 0x14b5 0x148d 0x1e0d 0x1aef 0x1831 0x159e 0x14b5 0x148e 0x1dff 0x1ae3 0x1835 0x159f 0x14b6 0x148e 0x1df5 0x1adf 0x183a 0x15a1 0x14b7 0x148f 0x1df6 0x1ae5 0x1841 0x15a5 0x14b9 0x1491 0x1df6 0x1aeb 0x184c 0x15a8 0x14ba 0x1492 0x1df6 0x1af2 0x1849 0x15aa 0x14bb 0x1493 0x1dfa 0x1af8 0x1850 0x15af 0x14be 0x1495 0x1e04 0x1b0b 0x1850 0x15b1 0x14be 0x1496 0x1e09 0x1b08 0x1859 0x15b4 0x14be 0x1496 0x1e26 0x1b0e 0x1863 0x15b4 0x14be 0x1496 0x1e37 0x1b0b 0x186b 0x15b6 0x14bf 0x1496 0x1e2c 0x1b1e 0x1867 0x15b9 0x14c2 0x1498 0x1e29 0x1b3f 0x1879 0x15c2 0x14c5 0x149b 0x1e38 0x1b5b 0x1895 0x15d1 0x14cc 0x14a0 0x1e61 0x1b5f 0x18a8 0x15e4 0x14d3 0x14a6 0x1eb6 0x1b7e 0x18ca 0x15f7 0x14dc 0x14ac 0x1eb6 0x1b7e 0x18ca 0x15f7 0x14dc 0x14ac 0x1eb6 0x1b7e 0x18ca 0x15f7 0x14dc 0x14ac>;
						qcom,lut-row-legend = <0x2710 0x2648 0x2580 0x24b8 0x23f0 0x2328 0x2260 0x2198 0x20d0 0x2008 0x1f40 0x1e78 0x1db0 0x1ce8 0x1c20 0x1b58 0x1a90 0x19c8 0x1900 0x1838 0x1770 0x16a8 0x15e0 0x1518 0x1450 0x1388 0x12c0 0x11f8 0x1130 0x1068 0xfa0 0xed8 0xe10 0xd48 0xc80 0xbb8 0xaf0 0xa28 0x960 0x898 0x7d0 0x708 0x640 0x578 0x4b0 0x3e8 0x384 0x320 0x2bc 0x258 0x1f4 0x190 0x12c 0xc8 0x64 0x0>;
					};

					qcom,pc-temp-y2-lut {
						qcom,lut-col-legend = <0xfffffff6 0x0 0xa 0x19 0x28 0x32>;
						qcom,lut-data = <0x25d6 0x28a1 0x29b8 0x2b2a 0x2b60 0x2c89 0x2638 0x287f 0x299b 0x2b15 0x2b62 0x2c51 0x2674 0x286a 0x297a 0x2afb 0x2b61 0x2bfc 0x2693 0x285f 0x2959 0x2ade 0x2b5e 0x2ba2 0x269f 0x285b 0x293d 0x2abd 0x2b58 0x2b5a 0x26a2 0x285a 0x292b 0x2a9a 0x2b51 0x2b3c 0x266c 0x2867 0x2922 0x2a6d 0x2b48 0x2b43 0x260b 0x287d 0x291b 0x2a3f 0x2b3b 0x2b4e 0x25f2 0x2878 0x2916 0x2a29 0x2b28 0x2b4d 0x25fe 0x283e 0x2912 0x2a1c 0x2b09 0x2b3a 0x2615 0x2814 0x2910 0x2a13 0x2ae5 0x2b24 0x2698 0x2862 0x291a 0x2a04 0x2ab6 0x2afb 0x2784 0x28ea 0x2933 0x29f0 0x2a85 0x2ac3 0x27ba 0x2909 0x295a 0x29f2 0x2a7a 0x2abc 0x26d8 0x28f6 0x29a8 0x2a1d 0x2a90 0x2af0 0x2601 0x28e9 0x29e0 0x2a53 0x2ab0 0x2b19 0x25e5 0x28ff 0x29fa 0x2a91 0x2aec 0x2b1b 0x25de 0x2924 0x2a0e 0x2ad0 0x2b33 0x2b18 0x25d8 0x292d 0x2a1d 0x2aef 0x2b47 0x2b23 0x25d2 0x292c 0x2a2b 0x2afc 0x2b48 0x2b59 0x25cd 0x2929 0x2a36 0x2b0a 0x2b4a 0x2b9b 0x25ca 0x28f3 0x2a3f 0x2b29 0x2b78 0x2bd9 0x25c8 0x2849 0x2a48 0x2b54 0x2bc0 0x2c13 0x25c6 0x27d1 0x2a4b 0x2b74 0x2be2 0x2c3d 0x25c3 0x275f 0x2a50 0x2b8f 0x2bf6 0x2c5c 0x25c0 0x271c 0x2a54 0x2ba1 0x2c07 0x2c71 0x25bf 0x270e 0x2a52 0x2bac 0x2c19 0x2c83 0x25be 0x2700 0x2a4a 0x2bb0 0x2c2d 0x2c96 0x25bd 0x26ed 0x2a46 0x2ba7 0x2c35 0x2cb5 0x25bc 0x26d4 0x2a44 0x2b8e 0x2c41 0x2cec 0x25bb 0x26b9 0x2a3f 0x2b80 0x2c4d 0x2d11 0x25bb 0x26a1 0x29e9 0x2b83 0x2c40 0x2d02 0x25ba 0x268b 0x294e 0x2b8f 0x2c2f 0x2cda 0x25b9 0x2672 0x290b 0x2b9c 0x2c33 0x2cca 0x25b8 0x2655 0x28fa 0x2b99 0x2c39 0x2cd1 0x25b8 0x263a 0x28ee 0x2b84 0x2c35 0x2cd6 0x25b7 0x2622 0x28e6 0x2b68 0x2c34 0x2cdc 0x25b7 0x2604 0x290b 0x2b59 0x2c39 0x2ce8 0x25b6 0x25ec 0x293c 0x2b5f 0x2c3b 0x2ce7 0x25b6 0x25de 0x291d 0x2b60 0x2c36 0x2cd1 0x25b6 0x25d4 0x28ba 0x2b5f 0x2c32 0x2cc5 0x25b6 0x25cb 0x289c 0x2b62 0x2c34 0x2ccc 0x25b6 0x25c4 0x28a6 0x2b5d 0x2c32 0x2ccf 0x25b5 0x25be 0x281b 0x2b46 0x2c13 0x2cc8 0x25b5 0x25bb 0x27d7 0x2b34 0x2c13 0x2cb0 0x25b5 0x25bb 0x27c4 0x2b11 0x2c20 0x2c82 0x25b5 0x25ba 0x2810 0x2b0d 0x2c0a 0x2c51 0x25b5 0x25b9 0x2851 0x2b23 0x2be8 0x2c48 0x25b5 0x25b8 0x2853 0x2b28 0x2bef 0x2c50 0x25b4 0x25b8 0x2837 0x2ae6 0x2c1e 0x2c3a 0x25b4 0x25b6 0x2800 0x2acc 0x2bf7 0x2bfd 0x25b4 0x25b5 0x27bc 0x2aa1 0x2b7e 0x2ba7 0x25b4 0x25b4 0x2786 0x2a49 0x2b0f 0x2b35 0x25b2 0x25b4 0x2773 0x2a1c 0x2a4f 0x2a4a 0x25b2 0x25b4 0x2773 0x2a1c 0x2a4f 0x2a4a 0x25b2 0x25b4 0x2773 0x2a1c 0x2a4f 0x2a4a>;
						qcom,lut-row-legend = <0x2710 0x2648 0x2580 0x24b8 0x23f0 0x2328 0x2260 0x2198 0x20d0 0x2008 0x1f40 0x1e78 0x1db0 0x1ce8 0x1c20 0x1b58 0x1a90 0x19c8 0x1900 0x1838 0x1770 0x16a8 0x15e0 0x1518 0x1450 0x1388 0x12c0 0x11f8 0x1130 0x1068 0xfa0 0xed8 0xe10 0xd48 0xc80 0xbb8 0xaf0 0xa28 0x960 0x898 0x7d0 0x708 0x640 0x578 0x4b0 0x3e8 0x384 0x320 0x2bc 0x258 0x1f4 0x190 0x12c 0xc8 0x64 0x0>;
					};

					qcom,pc-temp-y3-lut {
						qcom,lut-col-legend = <0xfffffff6 0x0 0xa 0x19 0x28 0x32>;
						qcom,lut-data = <0x347a 0x3456 0x3421 0x33e5 0x33e0 0x33d8 0x356b 0x345f 0x341a 0x33e4 0x33e0 0x33da 0x35ff 0x346c 0x3416 0x33e3 0x33e0 0x33db 0x364d 0x3479 0x3416 0x33e3 0x33e0 0x33dd 0x366b 0x3484 0x3418 0x33e3 0x33e0 0x33de 0x3670 0x3489 0x341c 0x33e5 0x33e0 0x33de 0x35ec 0x3489 0x3423 0x33e8 0x33e0 0x33de 0x34fc 0x3488 0x342b 0x33ed 0x33e1 0x33de 0x34bb 0x348b 0x342e 0x33ef 0x33e1 0x33de 0x34ba 0x349e 0x342f 0x33f0 0x33e1 0x33dd 0x34bb 0x34ac 0x3430 0x33f0 0x33e1 0x33dd 0x34d3 0x349e 0x343d 0x33f7 0x33e4 0x33df 0x3504 0x3481 0x3450 0x3401 0x33e9 0x33e2 0x3510 0x3471 0x3451 0x3402 0x33ea 0x33e3 0x34ec 0x3468 0x343b 0x33fe 0x33e8 0x33e2 0x34cc 0x3462 0x3427 0x33fb 0x33e6 0x33e2 0x34d0 0x345f 0x3422 0x33fd 0x33e8 0x33e2 0x34e0 0x345d 0x341f 0x3401 0x33ec 0x33e3 0x34e7 0x345a 0x341b 0x3401 0x33ec 0x33e3 0x34e9 0x3455 0x3416 0x33f9 0x33e7 0x33e0 0x34ea 0x344f 0x3411 0x33f0 0x33e3 0x33dd 0x34ec 0x3445 0x340c 0x33e8 0x33e1 0x33dc 0x34f0 0x3435 0x3407 0x33e3 0x33e0 0x33db 0x34f5 0x3427 0x3406 0x33e2 0x33df 0x33db 0x3500 0x341c 0x3405 0x33e3 0x33de 0x33db 0x3512 0x3417 0x3405 0x33e4 0x33de 0x33da 0x3525 0x3418 0x3405 0x33e3 0x33de 0x33da 0x3539 0x341b 0x3405 0x33e3 0x33dd 0x33da 0x354f 0x341f 0x3405 0x33e5 0x33dd 0x33da 0x356b 0x3423 0x3405 0x33e9 0x33dd 0x33d9 0x358d 0x3428 0x3405 0x33ec 0x33dd 0x33d9 0x35b2 0x342d 0x3400 0x33ed 0x33de 0x33d9 0x35da 0x3434 0x33f9 0x33ec 0x33de 0x33da 0x360a 0x343c 0x33f6 0x33ec 0x33df 0x33da 0x3641 0x3449 0x33f7 0x33ea 0x33de 0x33da 0x3680 0x3458 0x33f8 0x33e8 0x33de 0x33d9 0x36c1 0x3468 0x33fb 0x33e6 0x33de 0x33d9 0x3702 0x347a 0x3402 0x33e4 0x33dd 0x33d9 0x3742 0x3490 0x3408 0x33e3 0x33dd 0x33d9 0x3781 0x34b0 0x340c 0x33e3 0x33dd 0x33d9 0x37c1 0x34dc 0x340f 0x33e3 0x33dd 0x33d9 0x3803 0x3511 0x3415 0x33e3 0x33de 0x33da 0x3845 0x3550 0x341e 0x33e3 0x33de 0x33da 0x3892 0x35a3 0x3421 0x33e4 0x33de 0x33da 0x38ea 0x3613 0x3429 0x33e3 0x33de 0x33da 0x390d 0x3642 0x3430 0x33eb 0x33df 0x33dc 0x393f 0x363e 0x3435 0x33ec 0x33e1 0x33dd 0x395c 0x3658 0x3442 0x33f0 0x33e3 0x33e0 0x398d 0x36b9 0x3451 0x33f2 0x33e2 0x33e0 0x3a0b 0x3718 0x3452 0x33ee 0x33e1 0x33dd 0x3a97 0x37a6 0x345a 0x33f0 0x33e0 0x33dd 0x3b31 0x3888 0x346f 0x33f5 0x33e3 0x33e1 0x3c10 0x3978 0x3492 0x33f9 0x33e6 0x33e4 0x3f2c 0x3a7b 0x34ca 0x3403 0x33ea 0x33e6 0x3f2c 0x3a7b 0x34ca 0x3403 0x33ea 0x33e6 0x3f2c 0x3a7b 0x34ca 0x3403 0x33ea 0x33e6>;
						qcom,lut-row-legend = <0x2710 0x2648 0x2580 0x24b8 0x23f0 0x2328 0x2260 0x2198 0x20d0 0x2008 0x1f40 0x1e78 0x1db0 0x1ce8 0x1c20 0x1b58 0x1a90 0x19c8 0x1900 0x1838 0x1770 0x16a8 0x15e0 0x1518 0x1450 0x1388 0x12c0 0x11f8 0x1130 0x1068 0xfa0 0xed8 0xe10 0xd48 0xc80 0xbb8 0xaf0 0xa28 0x960 0x898 0x7d0 0x708 0x640 0x578 0x4b0 0x3e8 0x384 0x320 0x2bc 0x258 0x1f4 0x190 0x12c 0xc8 0x64 0x0>;
					};

					qcom,pc-temp-y4-lut {
						qcom,lut-col-legend = <0xfffffff6 0x0 0xa 0x19 0x28 0x32>;
						qcom,lut-data = <0x45b5 0x41d2 0x40f2 0x406d 0x4045 0x4044 0x452b 0x41db 0x40ef 0x4073 0x4045 0x4042 0x44eb 0x41eb 0x40ef 0x4078 0x4047 0x4041 0x44e9 0x4200 0x40f2 0x407b 0x4048 0x4040 0x4515 0x421b 0x40f7 0x407d 0x404a 0x4040 0x4561 0x4239 0x40fe 0x407e 0x404b 0x4040 0x4627 0x4263 0x4106 0x407c 0x404d 0x4041 0x478b 0x428e 0x4111 0x407a 0x404e 0x4044 0x4914 0x42a4 0x411c 0x407a 0x4051 0x4046 0x4b24 0x42ad 0x4127 0x4081 0x4055 0x4049 0x4c74 0x42bc 0x4138 0x408c 0x405b 0x404d 0x4a3e 0x4407 0x419f 0x409e 0x4069 0x4059 0x4560 0x4626 0x4237 0x40b4 0x407d 0x4068 0x437a 0x4642 0x4251 0x40bd 0x4081 0x406c 0x4347 0x43a8 0x4203 0x40bf 0x407d 0x406b 0x432d 0x41b1 0x41aa 0x40c3 0x407b 0x406a 0x4320 0x41b5 0x416e 0x40ec 0x4091 0x407a 0x430d 0x41e2 0x413b 0x4129 0x40ba 0x4098 0x42ef 0x41ed 0x4117 0x412a 0x40c0 0x409d 0x42b4 0x41c5 0x40fa 0x40d1 0x4094 0x407d 0x4274 0x4198 0x40e3 0x4085 0x4066 0x405b 0x4249 0x4180 0x40d4 0x4078 0x4054 0x404d 0x4228 0x416e 0x40c8 0x4072 0x4049 0x4043 0x421f 0x416b 0x40c2 0x406f 0x4048 0x4042 0x4223 0x415f 0x40be 0x406b 0x4048 0x4042 0x422b 0x414f 0x40bb 0x4069 0x4049 0x4043 0x4231 0x4143 0x40ba 0x406b 0x404b 0x4045 0x423b 0x4137 0x40ba 0x406d 0x404e 0x4048 0x4246 0x4136 0x40b9 0x406e 0x4051 0x404c 0x4252 0x4142 0x40b4 0x4070 0x4057 0x4051 0x425e 0x4154 0x40b0 0x4072 0x405e 0x4058 0x426a 0x4167 0x40b4 0x4074 0x4068 0x4063 0x4276 0x417f 0x40bd 0x4076 0x4073 0x4070 0x4283 0x4198 0x40c4 0x4074 0x4075 0x4072 0x4290 0x41b2 0x40c9 0x4069 0x4064 0x4061 0x429c 0x41cd 0x40cd 0x405e 0x404f 0x404c 0x42a8 0x41ef 0x40d2 0x405b 0x4044 0x4043 0x42b5 0x421f 0x40d8 0x4059 0x403e 0x403f 0x42c7 0x4244 0x40dc 0x405a 0x403e 0x4040 0x42e1 0x4252 0x40e9 0x405d 0x4042 0x4045 0x4308 0x425c 0x40fd 0x4060 0x4047 0x404a 0x433b 0x4262 0x410c 0x4063 0x4048 0x404b 0x437e 0x4270 0x4118 0x4064 0x4046 0x4048 0x43d3 0x4287 0x4129 0x4061 0x403d 0x403b 0x442a 0x42c2 0x4147 0x406b 0x4041 0x403e 0x441b 0x42ef 0x4160 0x4075 0x4057 0x405a 0x441e 0x4307 0x4166 0x4084 0x4070 0x4078 0x43ed 0x432a 0x4193 0x40a2 0x4099 0x40a2 0x43d0 0x436e 0x41e6 0x40be 0x409c 0x4098 0x43e5 0x4383 0x41de 0x409e 0x406e 0x4064 0x43f6 0x4384 0x41d8 0x409e 0x4060 0x4059 0x4411 0x43a0 0x41fb 0x40bd 0x4070 0x4067 0x4463 0x43f1 0x4266 0x40fb 0x4090 0x4085 0x470a 0x44a2 0x432d 0x41de 0x4141 0x4118 0x470a 0x44a2 0x432d 0x41de 0x4141 0x4118 0x470a 0x44a2 0x432d 0x41de 0x4141 0x4118>;
						qcom,lut-row-legend = <0x2710 0x2648 0x2580 0x24b8 0x23f0 0x2328 0x2260 0x2198 0x20d0 0x2008 0x1f40 0x1e78 0x1db0 0x1ce8 0x1c20 0x1b58 0x1a90 0x19c8 0x1900 0x1838 0x1770 0x16a8 0x15e0 0x1518 0x1450 0x1388 0x12c0 0x11f8 0x1130 0x1068 0xfa0 0xed8 0xe10 0xd48 0xc80 0xbb8 0xaf0 0xa28 0x960 0x898 0x7d0 0x708 0x640 0x578 0x4b0 0x3e8 0x384 0x320 0x2bc 0x258 0x1f4 0x190 0x12c 0xc8 0x64 0x0>;
					};

					qcom,pc-temp-y5-lut {
						qcom,lut-col-legend = <0xfffffff6 0x0 0xa 0x19 0x28 0x32>;
						qcom,lut-data = <0x2208 0x348a 0x3ab0 0x3545 0x4573 0x3634 0x2208 0x34aa 0x3839 0x3326 0x4393 0x3e82 0x269f 0x34e2 0x3660 0x31db 0x419b 0x43da 0x2f8b 0x3522 0x3519 0x3130 0x3fbf 0x46e0 0x3428 0x3557 0x345a 0x30f0 0x3e34 0x4838 0x3590 0x3572 0x341a 0x30e7 0x3d2f 0x4884 0x30ee 0x3576 0x34b3 0x32d3 0x3ca4 0x46c7 0x2869 0x3578 0x35a4 0x35e5 0x3c3f 0x4385 0x267f 0x34b6 0x35c2 0x3648 0x3b81 0x4119 0x2a54 0x3032 0x3545 0x34d0 0x3996 0x3e92 0x2ff6 0x2cf8 0x3494 0x33cf 0x387f 0x3ce5 0x37e1 0x2fd6 0x333d 0x3525 0x3964 0x3cfd 0x4112 0x360e 0x319c 0x3768 0x3acb 0x3dbd 0x4280 0x3a64 0x326c 0x37dc 0x3b0d 0x3dbf 0x373b 0x3dd4 0x395e 0x3745 0x3a7a 0x3cb2 0x2cf9 0x3f72 0x3eca 0x36d1 0x3a41 0x3bb0 0x2d03 0x3ec5 0x3f83 0x384b 0x3ae8 0x3b5d 0x2edc 0x3dc2 0x3fc3 0x3b9d 0x3c38 0x3b2b 0x2f8c 0x3d9a 0x3f92 0x3dc7 0x3e57 0x3b93 0x2f1e 0x3df3 0x3ecf 0x3f34 0x4225 0x3e9f 0x2e5c 0x3e54 0x3de6 0x3fc8 0x445b 0x4233 0x2d64 0x3c6d 0x3c08 0x3c17 0x4527 0x44e0 0x2c30 0x3697 0x3971 0x3578 0x4604 0x471b 0x2b6b 0x3248 0x38a0 0x33d2 0x4627 0x47ff 0x2b06 0x2f1a 0x38d8 0x353a 0x4512 0x484d 0x2ad4 0x2d6f 0x3925 0x3660 0x43d2 0x484f 0x2add 0x2d4c 0x3975 0x3678 0x4315 0x4790 0x2aec 0x2d55 0x39cc 0x366c 0x4294 0x45bc 0x2af3 0x2d44 0x3a34 0x38ed 0x427b 0x43ff 0x2b16 0x2d12 0x3b09 0x40ee 0x4270 0x426f 0x2b4e 0x2d07 0x3ba6 0x465a 0x4280 0x41aa 0x2b80 0x2d07 0x38cb 0x47e5 0x43ef 0x42bb 0x2ba9 0x2cec 0x3382 0x48db 0x472c 0x45f6 0x2bd0 0x2ce9 0x319e 0x48b8 0x4a98 0x495f 0x2bf8 0x2d41 0x31a4 0x45bb 0x4e8c 0x4c69 0x2c20 0x2daa 0x31b5 0x4185 0x51da 0x4ea9 0x2c45 0x2dd9 0x3221 0x3e14 0x52fb 0x508e 0x2c64 0x2d8a 0x34af 0x3aee 0x5257 0x524a 0x2c6c 0x2d32 0x3713 0x3918 0x50bc 0x5292 0x2c5a 0x2d52 0x36de 0x38bf 0x4e90 0x50e7 0x2c45 0x2d99 0x34f7 0x3913 0x4dbc 0x4f8f 0x2c53 0x2da9 0x354f 0x3906 0x4ea8 0x5136 0x2cb7 0x2d71 0x370b 0x3898 0x515e 0x56c7 0x2d6c 0x2d2c 0x33cd 0x3962 0x555b 0x5c52 0x2e6e 0x2cc8 0x325a 0x3610 0x4cc2 0x4ea4 0x2fc4 0x2d10 0x320a 0x3e49 0x4394 0x4373 0x30b0 0x2d1b 0x3431 0x3e08 0x42cc 0x40b6 0x322c 0x2e86 0x370e 0x4092 0x40be 0x3f21 0x3256 0x3099 0x3915 0x3fe1 0x3e27 0x3e5b 0x322c 0x3127 0x38b1 0x3e5f 0x428d 0x410e 0x3117 0x3039 0x38e1 0x4283 0x4414 0x4431 0x2f77 0x2f18 0x37f8 0x4528 0x4741 0x4a06 0x2e6f 0x2e5e 0x37ca 0x4396 0x477b 0x4ab1 0x2b65 0x2d9d 0x3932 0x4343 0x45a6 0x476b 0x2b65 0x2d9d 0x3932 0x4343 0x45a6 0x476b 0x2b65 0x2d9d 0x3932 0x4343 0x45a6 0x476b>;
						qcom,lut-row-legend = <0x2710 0x2648 0x2580 0x24b8 0x23f0 0x2328 0x2260 0x2198 0x20d0 0x2008 0x1f40 0x1e78 0x1db0 0x1ce8 0x1c20 0x1b58 0x1a90 0x19c8 0x1900 0x1838 0x1770 0x16a8 0x15e0 0x1518 0x1450 0x1388 0x12c0 0x11f8 0x1130 0x1068 0xfa0 0xed8 0xe10 0xd48 0xc80 0xbb8 0xaf0 0xa28 0x960 0x898 0x7d0 0x708 0x640 0x578 0x4b0 0x3e8 0x384 0x320 0x2bc 0x258 0x1f4 0x190 0x12c 0xc8 0x64 0x0>;
					};

					qcom,pc-temp-y6-lut {
						qcom,lut-col-legend = <0xfffffff6 0x0 0xa 0x19 0x28 0x32>;
						qcom,lut-data = <0x1af4 0x1607 0x1492 0x13c9 0x139d 0x1392 0x1afb 0x160e 0x148d 0x13c8 0x139d 0x1393 0x1aff 0x1616 0x148a 0x13c7 0x139d 0x1394 0x1aff 0x161e 0x148a 0x13c8 0x139d 0x1395 0x1afc 0x1626 0x148c 0x13c9 0x139e 0x1395 0x1af7 0x162e 0x148e 0x13ca 0x139f 0x1396 0x1ac7 0x1636 0x1494 0x13cc 0x139f 0x1397 0x1a78 0x163e 0x149c 0x13cf 0x13a1 0x1397 0x1a74 0x1646 0x14a1 0x13d2 0x13a2 0x1398 0x1aff 0x164c 0x14a3 0x13d4 0x13a3 0x1399 0x1b70 0x1657 0x14a8 0x13d7 0x13a5 0x139a 0x1af4 0x16ac 0x14cc 0x13e2 0x13ac 0x139f 0x19d3 0x172c 0x1503 0x13ef 0x13b5 0x13a6 0x1941 0x172c 0x150b 0x13f2 0x13b7 0x13a8 0x190e 0x1670 0x14e5 0x13f1 0x13b5 0x13a7 0x18f6 0x15e2 0x14be 0x13f0 0x13b3 0x13a7 0x18fb 0x15e4 0x14ab 0x13fd 0x13bb 0x13ac 0x1909 0x15f5 0x149c 0x1412 0x13c9 0x13b5 0x190d 0x15f9 0x148f 0x1412 0x13cb 0x13b7 0x190c 0x15ed 0x1483 0x13f3 0x13bb 0x13ab 0x190a 0x15e0 0x147a 0x13d6 0x13ab 0x139f 0x190d 0x15d6 0x1473 0x13cd 0x13a4 0x139a 0x191a 0x15ce 0x146e 0x13c8 0x13a1 0x1397 0x192c 0x15c9 0x146d 0x13c7 0x13a0 0x1397 0x1945 0x15c7 0x146e 0x13c7 0x13a0 0x1397 0x1964 0x15c6 0x146f 0x13c8 0x13a0 0x1398 0x1982 0x15cb 0x1470 0x13c9 0x13a1 0x1398 0x19a0 0x15d5 0x1473 0x13ca 0x13a2 0x1399 0x19c0 0x15e2 0x1475 0x13cc 0x13a3 0x139a 0x19e6 0x15f3 0x1476 0x13d0 0x13a5 0x139c 0x1a11 0x1607 0x1477 0x13d4 0x13a7 0x139e 0x1a3f 0x161d 0x1478 0x13d6 0x13ab 0x13a2 0x1a72 0x1638 0x1479 0x13d7 0x13af 0x13a6 0x1aa7 0x1655 0x147b 0x13d6 0x13b0 0x13a7 0x1ae0 0x1676 0x147f 0x13d2 0x13ab 0x13a2 0x1b1c 0x169b 0x1483 0x13ce 0x13a5 0x139c 0x1b59 0x16c6 0x1488 0x13cc 0x13a2 0x139a 0x1b96 0x16f8 0x1490 0x13cb 0x13a0 0x1398 0x1bd4 0x1732 0x149a 0x13ca 0x13a0 0x1399 0x1c13 0x1772 0x14a5 0x13cb 0x13a1 0x139a 0x1c51 0x17bc 0x14b0 0x13cd 0x13a3 0x139c 0x1c90 0x1811 0x14bf 0x13ce 0x13a4 0x139d 0x1cd3 0x1875 0x14d0 0x13cf 0x13a3 0x139c 0x1d22 0x18ef 0x14e0 0x13d0 0x13a1 0x1399 0x1d80 0x1984 0x14f9 0x13d2 0x13a3 0x139a 0x1da5 0x19b9 0x150c 0x13db 0x13a9 0x13a3 0x1dcf 0x19c4 0x1513 0x13e1 0x13b2 0x13ad 0x1dde 0x19e7 0x152f 0x13ec 0x13bf 0x13bb 0x1e04 0x1a57 0x155a 0x13f6 0x13c0 0x13b8 0x1e6d 0x1abf 0x1560 0x13eb 0x13b2 0x13a7 0x1edf 0x1b41 0x1573 0x13ee 0x13ae 0x13a5 0x1f66 0x1c0d 0x15ab 0x13fd 0x13b6 0x13ac 0x2034 0x1cdf 0x160e 0x1415 0x13c2 0x13b7 0x23c8 0x1de5 0x16a3 0x1461 0x13f8 0x13e4 0x23c8 0x1de5 0x16a3 0x1461 0x13f8 0x13e4 0x23c8 0x1de5 0x16a3 0x1461 0x13f8 0x13e4>;
						qcom,lut-row-legend = <0x2710 0x2648 0x2580 0x24b8 0x23f0 0x2328 0x2260 0x2198 0x20d0 0x2008 0x1f40 0x1e78 0x1db0 0x1ce8 0x1c20 0x1b58 0x1a90 0x19c8 0x1900 0x1838 0x1770 0x16a8 0x15e0 0x1518 0x1450 0x1388 0x12c0 0x11f8 0x1130 0x1068 0xfa0 0xed8 0xe10 0xd48 0xc80 0xbb8 0xaf0 0xa28 0x960 0x898 0x7d0 0x708 0x640 0x578 0x4b0 0x3e8 0x384 0x320 0x2bc 0x258 0x1f4 0x190 0x12c 0xc8 0x64 0x0>;
					};

					qcom,pc-temp-z1-lut {
						qcom,lut-col-legend = <0x0 0xa 0x19 0x28 0x32>;
						qcom,lut-data = <0x38d1 0x33b6 0x2f09 0x2da0 0x2d49 0x38bb 0x337f 0x2f0d 0x2d9e 0x2d52 0x38c3 0x3376 0x2f0b 0x2da5 0x2d5c 0x38c7 0x337e 0x2f07 0x2da7 0x2d60 0x38d3 0x3382 0x2f03 0x2da8 0x2d62 0x38eb 0x337d 0x2f01 0x2da8 0x2d64 0x38ff 0x336c 0x2f02 0x2da9 0x2d67 0x38f6 0x335e 0x2f03 0x2dac 0x2d6a 0x38d7 0x335d 0x2f05 0x2dae 0x2d6d 0x38b6 0x3362 0x2f09 0x2db1 0x2d6f 0x3896 0x3360 0x2f0d 0x2db5 0x2d72 0x3874 0x334e 0x2f0f 0x2db8 0x2d77 0x3843 0x333c 0x2f0f 0x2dbb 0x2d7b 0x3810 0x332e 0x2f0b 0x2dbb 0x2d7c 0x37ee 0x3328 0x2f04 0x2db9 0x2d7c 0x37d3 0x3329 0x2f01 0x2db7 0x2d7c 0x37b6 0x3329 0x2f04 0x2dbb 0x2d7f 0x3792 0x332c 0x2f0a 0x2dc2 0x2d85 0x3772 0x3337 0x2f14 0x2dc9 0x2d8b 0x3765 0x3349 0x2f21 0x2dce 0x2d8f 0x3763 0x335e 0x2f2c 0x2dd3 0x2d93 0x376a 0x3374 0x2f35 0x2dd8 0x2d98 0x3773 0x3384 0x2f3d 0x2ddd 0x2d9c 0x377f 0x338b 0x2f45 0x2de1 0x2da1 0x3787 0x3391 0x2f4d 0x2de7 0x2da6 0x378c 0x339a 0x2f54 0x2dec 0x2daa 0x378f 0x33a6 0x2f5b 0x2df0 0x2daf 0x3794 0x33ad 0x2f62 0x2df4 0x2db3 0x379f 0x33b2 0x2f69 0x2df8 0x2db7 0x37af 0x33ba 0x2f6f 0x2dfc 0x2dbb 0x37c7 0x33c2 0x2f75 0x2e00 0x2dbf 0x37de 0x33c9 0x2f7a 0x2e04 0x2dc4 0x37e6 0x33d1 0x2f80 0x2e08 0x2dc8 0x37ea 0x33de 0x2f86 0x2e0d 0x2dcd 0x37f0 0x33f1 0x2f8e 0x2e12 0x2dd1 0x3807 0x3403 0x2f95 0x2e17 0x2dd5 0x383b 0x3415 0x2f9d 0x2e1a 0x2dd8 0x386b 0x3422 0x2fa5 0x2e1c 0x2dda 0x3891 0x3427 0x2faa 0x2e1f 0x2ddc 0x38b0 0x3429 0x2fad 0x2e21 0x2ddd 0x38b2 0x342d 0x2fb1 0x2e23 0x2dde 0x3888 0x3439 0x2fb9 0x2e25 0x2de0 0x3873 0x3448 0x2fbf 0x2e27 0x2de1 0x386e 0x3457 0x2fc0 0x2e28 0x2de2 0x3861 0x3449 0x2fc4 0x2e29 0x2de2 0x386f 0x3454 0x2fc7 0x2e2b 0x2de2 0x3869 0x3454 0x2fc8 0x2e2b 0x2de1 0x3868 0x345b 0x2fc9 0x2e2b 0x2de2 0x385f 0x3457 0x2fcf 0x2e2c 0x2de3 0x387c 0x3452 0x2fd1 0x2e30 0x2de6 0x3886 0x346f 0x2fdb 0x2e36 0x2deb 0x38aa 0x3476 0x2ff3 0x2e3f 0x2df0 0x3895 0x349e 0x3007 0x2e4a 0x2dfa 0x38d0 0x34c8 0x3032 0x2e5c 0x2e06 0x38d0 0x34c8 0x3032 0x2e5c 0x2e06 0x38d0 0x34c8 0x3032 0x2e5c 0x2e06>;
						qcom,lut-row-legend = <0x2710 0x2648 0x2580 0x24b8 0x23f0 0x2328 0x2260 0x2198 0x20d0 0x2008 0x1f40 0x1e78 0x1db0 0x1ce8 0x1c20 0x1b58 0x1a90 0x19c8 0x1900 0x1838 0x1770 0x16a8 0x15e0 0x1518 0x1450 0x1388 0x12c0 0x11f8 0x1130 0x1068 0xfa0 0xed8 0xe10 0xd48 0xc80 0xbb8 0xaf0 0xa28 0x960 0x898 0x7d0 0x708 0x640 0x578 0x4b0 0x3e8 0x384 0x320 0x2bc 0x258 0x1f4 0x190 0x12c 0xc8 0x64 0x0>;
					};

					qcom,pc-temp-z2-lut {
						qcom,lut-col-legend = <0x0 0xa 0x19 0x28 0x32>;
						qcom,lut-data = <0x2bb8 0x2632 0x2811 0x296b 0x2a9e 0x280d 0x2a3d 0x2824 0x28fa 0x293e 0x25fe 0x2926 0x282f 0x28bc 0x28c4 0x2606 0x274d 0x282a 0x28ad 0x28ac 0x2620 0x26d2 0x281d 0x2898 0x28a6 0x262f 0x26c3 0x2815 0x288c 0x28a4 0x2631 0x26b5 0x2811 0x2887 0x28a8 0x262c 0x26aa 0x2812 0x2882 0x28ac 0x2625 0x26a2 0x2816 0x2880 0x28ac 0x261b 0x269c 0x2819 0x2884 0x28b5 0x2612 0x2698 0x2813 0x2887 0x28cc 0x2616 0x2696 0x27f3 0x288e 0x28d4 0x2626 0x2699 0x27d7 0x28ae 0x28d3 0x262c 0x26a7 0x27e8 0x28bd 0x28d4 0x2618 0x26b3 0x2814 0x289f 0x28d2 0x25f5 0x26b6 0x282a 0x2883 0x28c7 0x25e5 0x26ba 0x2827 0x288f 0x28d1 0x25e1 0x26c3 0x281d 0x28b2 0x290a 0x25dd 0x26dd 0x2837 0x28e1 0x2937 0x25d6 0x26fd 0x2894 0x2931 0x293f 0x25c9 0x271e 0x28ce 0x296a 0x293f 0x25be 0x2742 0x28b3 0x2939 0x2923 0x25b7 0x2760 0x2883 0x28bd 0x28ee 0x25b1 0x2775 0x2863 0x288b 0x28cc 0x259f 0x2784 0x284c 0x289e 0x28b4 0x2574 0x278c 0x283f 0x28b6 0x28a5 0x2552 0x2793 0x283c 0x28a9 0x28a6 0x2544 0x2797 0x283d 0x2890 0x28af 0x250b 0x2796 0x2845 0x2888 0x28ba 0x24d2 0x2793 0x2859 0x2888 0x28cd 0x24c0 0x2792 0x286f 0x288c 0x28e8 0x24b3 0x2793 0x2885 0x289f 0x290a 0x24aa 0x2795 0x289c 0x28c5 0x2934 0x24a2 0x2799 0x28b4 0x28ea 0x2962 0x249c 0x27a2 0x28ce 0x290a 0x299b 0x2498 0x27aa 0x28df 0x2925 0x29c7 0x249e 0x27b2 0x28e4 0x293c 0x29d8 0x24a4 0x27b7 0x28e7 0x2954 0x29e2 0x24ad 0x27bb 0x28ef 0x2961 0x29ed 0x24b6 0x27c0 0x28fb 0x2964 0x29f9 0x24b5 0x27c2 0x2901 0x2965 0x2a01 0x24a8 0x27b9 0x28fa 0x2971 0x2a03 0x24a4 0x279c 0x28f3 0x2981 0x2a07 0x24aa 0x26ec 0x28f1 0x2987 0x2a1d 0x246c 0x26c6 0x28d6 0x2992 0x2a3b 0x2459 0x26cc 0x28c6 0x29ad 0x2a38 0x2447 0x26dc 0x28df 0x29c9 0x2a6a 0x2449 0x26cd 0x293d 0x29ca 0x2a89 0x243a 0x26ed 0x297e 0x2a06 0x2aa5 0x243e 0x26c3 0x2925 0x29d7 0x2a55 0x2464 0x269c 0x28de 0x298a 0x29c5 0x246e 0x264f 0x28b9 0x2971 0x29af 0x2445 0x25fc 0x289b 0x2927 0x295f 0x241d 0x258f 0x282d 0x28da 0x2904 0x241d 0x258f 0x282d 0x28da 0x2904 0x241d 0x258f 0x282d 0x28da 0x2904>;
						qcom,lut-row-legend = <0x2710 0x2648 0x2580 0x24b8 0x23f0 0x2328 0x2260 0x2198 0x20d0 0x2008 0x1f40 0x1e78 0x1db0 0x1ce8 0x1c20 0x1b58 0x1a90 0x19c8 0x1900 0x1838 0x1770 0x16a8 0x15e0 0x1518 0x1450 0x1388 0x12c0 0x11f8 0x1130 0x1068 0xfa0 0xed8 0xe10 0xd48 0xc80 0xbb8 0xaf0 0xa28 0x960 0x898 0x7d0 0x708 0x640 0x578 0x4b0 0x3e8 0x384 0x320 0x2bc 0x258 0x1f4 0x190 0x12c 0xc8 0x64 0x0>;
					};

					qcom,pc-temp-z3-lut {
						qcom,lut-col-legend = <0x0 0xa 0x19 0x28 0x32>;
						qcom,lut-data = <0x4c45 0x4be7 0x4bad 0x4bb7 0x4b9b 0x4d48 0x4c26 0x4bd0 0x4baa 0x4b96 0x4dd0 0x4c76 0x4bee 0x4bac 0x4b97 0x4de1 0x4cc3 0x4bfa 0x4bb4 0x4b9c 0x4dce 0x4cd9 0x4bff 0x4bb6 0x4b9f 0x4db7 0x4cdc 0x4c00 0x4bb7 0x4ba2 0x4dac 0x4cdd 0x4bfe 0x4bb5 0x4ba2 0x4da7 0x4cdd 0x4bfb 0x4bb0 0x4b9f 0x4da5 0x4ce0 0x4bf8 0x4bac 0x4b9b 0x4da2 0x4ce2 0x4bf6 0x4bac 0x4b99 0x4da0 0x4cd4 0x4bf0 0x4bac 0x4b98 0x4da5 0x4cac 0x4bdf 0x4ba7 0x4b98 0x4db6 0x4c9a 0x4bc8 0x4b9b 0x4b95 0x4dc5 0x4cb6 0x4bce 0x4b96 0x4b91 0x4db4 0x4cd7 0x4bef 0x4ba3 0x4b93 0x4d83 0x4cd1 0x4c01 0x4bb3 0x4b97 0x4d54 0x4cac 0x4bec 0x4bad 0x4b94 0x4d30 0x4c8a 0x4bd0 0x4b9c 0x4b8a 0x4d0e 0x4c6f 0x4bcf 0x4b98 0x4b87 0x4cf1 0x4c5e 0x4be1 0x4ba6 0x4b8e 0x4cd8 0x4c62 0x4bee 0x4bb3 0x4b97 0x4cc6 0x4c75 0x4bef 0x4bb3 0x4b9d 0x4cbc 0x4c87 0x4bef 0x4bae 0x4ba1 0x4cb4 0x4c93 0x4bed 0x4bad 0x4ba2 0x4cac 0x4c9c 0x4bea 0x4bb4 0x4ba0 0x4ca3 0x4c9d 0x4be9 0x4bba 0x4b9e 0x4c97 0x4c9b 0x4bef 0x4bb7 0x4b9c 0x4c8c 0x4c97 0x4bf5 0x4bb2 0x4b9a 0x4c7f 0x4c91 0x4bf6 0x4bae 0x4b98 0x4c6f 0x4c8a 0x4bf4 0x4ba9 0x4b96 0x4c5d 0x4c84 0x4bf2 0x4ba5 0x4b94 0x4c4a 0x4c7f 0x4bef 0x4ba2 0x4b91 0x4c3a 0x4c7a 0x4bea 0x4ba0 0x4b8e 0x4c2b 0x4c73 0x4be7 0x4b9f 0x4b8a 0x4c1e 0x4c6b 0x4be5 0x4b9e 0x4b86 0x4c17 0x4c65 0x4be2 0x4b9e 0x4b84 0x4c1b 0x4c5f 0x4bde 0x4b9e 0x4b84 0x4c23 0x4c5a 0x4bda 0x4b9d 0x4b86 0x4c39 0x4c56 0x4bd7 0x4b9c 0x4b86 0x4c4f 0x4c53 0x4bd6 0x4b97 0x4b83 0x4c46 0x4c4f 0x4bd4 0x4b93 0x4b81 0x4c28 0x4c4a 0x4bd2 0x4b93 0x4b82 0x4c1b 0x4c3f 0x4bd0 0x4b93 0x4b82 0x4c19 0x4bfb 0x4bcc 0x4b93 0x4b83 0x4bac 0x4bb3 0x4bb6 0x4b90 0x4b7f 0x4b91 0x4b94 0x4ba0 0x4b89 0x4b78 0x4b89 0x4b8c 0x4b9e 0x4b80 0x4b70 0x4b8b 0x4b87 0x4b8e 0x4b7e 0x4b70 0x4b74 0x4b76 0x4b83 0x4b7c 0x4b6d 0x4b78 0x4b75 0x4b98 0x4b87 0x4b7c 0x4bab 0x4b91 0x4b9b 0x4b8b 0x4b83 0x4bda 0x4b96 0x4b9d 0x4b8e 0x4b84 0x4bf2 0x4b94 0x4b99 0x4b92 0x4b87 0x4c08 0x4ba0 0x4b9f 0x4b95 0x4b8c 0x4c08 0x4ba0 0x4b9f 0x4b95 0x4b8c 0x4c08 0x4ba0 0x4b9f 0x4b95 0x4b8c>;
						qcom,lut-row-legend = <0x2710 0x2648 0x2580 0x24b8 0x23f0 0x2328 0x2260 0x2198 0x20d0 0x2008 0x1f40 0x1e78 0x1db0 0x1ce8 0x1c20 0x1b58 0x1a90 0x19c8 0x1900 0x1838 0x1770 0x16a8 0x15e0 0x1518 0x1450 0x1388 0x12c0 0x11f8 0x1130 0x1068 0xfa0 0xed8 0xe10 0xd48 0xc80 0xbb8 0xaf0 0xa28 0x960 0x898 0x7d0 0x708 0x640 0x578 0x4b0 0x3e8 0x384 0x320 0x2bc 0x258 0x1f4 0x190 0x12c 0xc8 0x64 0x0>;
					};

					qcom,pc-temp-z4-lut {
						qcom,lut-col-legend = <0x0 0xa 0x19 0x28 0x32>;
						qcom,lut-data = <0x4001 0x3c8d 0x3a72 0x3978 0x397b 0x40ed 0x3c83 0x3a6f 0x39c6 0x39b9 0x40da 0x3c60 0x3a4a 0x39d2 0x39c2 0x4086 0x3c0a 0x3a21 0x39c0 0x39b5 0x4000 0x3ba1 0x39fb 0x39a7 0x399e 0x3f71 0x3b4a 0x39dc 0x3990 0x3986 0x3ef7 0x3b02 0x39c2 0x3981 0x3976 0x3e89 0x3acb 0x39ac 0x3976 0x396c 0x3e16 0x3aa0 0x39a0 0x3970 0x3966 0x3d82 0x3a79 0x399a 0x396d 0x3961 0x3cf4 0x3a50 0x3998 0x396a 0x395d 0x3cc5 0x3a2f 0x3998 0x3965 0x3959 0x3cdb 0x3a29 0x3999 0x395f 0x3951 0x3cf0 0x3a35 0x399d 0x3961 0x394e 0x3cc2 0x3a3c 0x39a2 0x3970 0x395b 0x3c4c 0x3a29 0x39a0 0x397b 0x3968 0x3beb 0x39fe 0x398c 0x396b 0x395e 0x3bb2 0x39dd 0x3979 0x394d 0x3947 0x3b8d 0x39c9 0x3978 0x394f 0x3946 0x3b7e 0x39bd 0x3982 0x3988 0x3974 0x3b75 0x39bc 0x3996 0x39ba 0x39a6 0x3b71 0x39bf 0x39ca 0x39be 0x39ab 0x3b75 0x39c9 0x39fe 0x39b9 0x399f 0x3b7b 0x39fa 0x39fe 0x39ae 0x3991 0x3b80 0x3a38 0x39df 0x3993 0x3982 0x3b85 0x3a46 0x39bf 0x397d 0x3975 0x3b8c 0x3a43 0x39a7 0x3973 0x396c 0x3b92 0x3a3e 0x3994 0x396e 0x3965 0x3b9e 0x3a2f 0x3989 0x3969 0x395f 0x3bab 0x3a18 0x3982 0x3965 0x395a 0x3bb3 0x3a05 0x397d 0x3962 0x3955 0x3bba 0x39f5 0x397b 0x395e 0x3951 0x3bbe 0x39e5 0x397a 0x395a 0x394e 0x3bbc 0x39d6 0x3979 0x395a 0x394d 0x3bb5 0x39c8 0x3979 0x395c 0x3950 0x3ba1 0x39ba 0x3978 0x395e 0x3955 0x3b72 0x39ac 0x3976 0x3961 0x395b 0x3b43 0x39a1 0x3973 0x3963 0x3961 0x3afc 0x399e 0x3970 0x3963 0x3963 0x3abc 0x399c 0x396d 0x3963 0x3960 0x3ab4 0x3999 0x396a 0x3962 0x395d 0x3abb 0x3994 0x3967 0x3960 0x395c 0x3ab9 0x3995 0x3962 0x395d 0x395b 0x3aa3 0x39d0 0x395a 0x3959 0x3958 0x3abd 0x39eb 0x3957 0x394b 0x394c 0x3ac6 0x39f6 0x3953 0x3935 0x3934 0x3acb 0x39f8 0x394d 0x3931 0x392d 0x3ac3 0x39fa 0x3959 0x3929 0x3920 0x3ad0 0x3a03 0x3961 0x3925 0x391e 0x3ac0 0x39ff 0x394e 0x392e 0x392c 0x3a9b 0x39f7 0x3956 0x3935 0x3930 0x3a8e 0x39fe 0x3959 0x3936 0x3935 0x3a94 0x3a0e 0x3963 0x3937 0x3936 0x3aa9 0x3a1d 0x3967 0x393a 0x3936 0x3aa9 0x3a1d 0x3967 0x393a 0x3936 0x3aa9 0x3a1d 0x3967 0x393a 0x3936>;
						qcom,lut-row-legend = <0x2710 0x2648 0x2580 0x24b8 0x23f0 0x2328 0x2260 0x2198 0x20d0 0x2008 0x1f40 0x1e78 0x1db0 0x1ce8 0x1c20 0x1b58 0x1a90 0x19c8 0x1900 0x1838 0x1770 0x16a8 0x15e0 0x1518 0x1450 0x1388 0x12c0 0x11f8 0x1130 0x1068 0xfa0 0xed8 0xe10 0xd48 0xc80 0xbb8 0xaf0 0xa28 0x960 0x898 0x7d0 0x708 0x640 0x578 0x4b0 0x3e8 0x384 0x320 0x2bc 0x258 0x1f4 0x190 0x12c 0xc8 0x64 0x0>;
					};

					qcom,pc-temp-z5-lut {
						qcom,lut-col-legend = <0x0 0xa 0x19 0x28 0x32>;
						qcom,lut-data = <0x2b3c 0x2daa 0x3498 0x4a8d 0x45cc 0x2ef0 0x3052 0x39fb 0x4721 0x484e 0x3117 0x343d 0x3f9f 0x4802 0x4a61 0x31df 0x385f 0x430e 0x4b83 0x4d9f 0x326a 0x3a69 0x44ec 0x4e02 0x5124 0x32f3 0x3bab 0x4673 0x5049 0x55e1 0x33c6 0x3ce5 0x4810 0x514c 0x5936 0x34d0 0x3e95 0x49be 0x511b 0x5a23 0x35db 0x4119 0x4b35 0x5160 0x5a1d 0x36fa 0x4312 0x4c4c 0x5327 0x5b6b 0x3859 0x42b6 0x4bad 0x5424 0x5e2c 0x3a2d 0x3f5c 0x45e6 0x5167 0x6138 0x3c44 0x3ed3 0x3ee4 0x49ed 0x6100 0x3d63 0x47a6 0x4250 0x472f 0x5e7d 0x3d9a 0x506d 0x5049 0x50b3 0x5f98 0x3db5 0x5016 0x57f1 0x5c40 0x639a 0x3dda 0x4c6d 0x532f 0x5d14 0x64bc 0x3dd6 0x4a75 0x4bb9 0x59b9 0x646c 0x3d86 0x49e6 0x55e6 0x5b90 0x6454 0x3cdc 0x49b6 0x76e4 0x6b24 0x646b 0x3bcd 0x5034 0x875d 0x7705 0x6492 0x3ad1 0x649b 0x78a4 0x6a60 0x5e9c 0x3a04 0x7968 0x6282 0x5014 0x511e 0x3939 0x8c1a 0x56c4 0x4873 0x4bc7 0x3846 0x9a39 0x4fd8 0x5026 0x4d8e 0x3716 0x9aa6 0x4dfb 0x5780 0x5074 0x35e9 0x91df 0x53c1 0x5aa0 0x53ba 0x34ed 0x87db 0x5d83 0x5d20 0x57f1 0x33ea 0x7eb5 0x65eb 0x5e8b 0x5cc6 0x32dd 0x764e 0x6eb9 0x601d 0x628a 0x31ca 0x720c 0x75c6 0x61b9 0x67fc 0x30bf 0x6fd5 0x79eb 0x63f1 0x6c9c 0x2ffa 0x6e15 0x7d26 0x6810 0x7085 0x2f5e 0x6c28 0x8068 0x6dc5 0x7165 0x2ed6 0x6a83 0x83d1 0x7653 0x6fdc 0x2e78 0x6a47 0x8529 0x7b5b 0x6e81 0x2ea9 0x6b32 0x8003 0x7adf 0x6f61 0x2f11 0x6ca0 0x7890 0x796f 0x710e 0x303e 0x6e9b 0x7749 0x7672 0x709c 0x317f 0x7119 0x77a9 0x6cad 0x6a94 0x3162 0x71bd 0x77df 0x65cc 0x65f5 0x300b 0x6c45 0x7771 0x66c4 0x66af 0x2fb0 0x60cd 0x7669 0x680b 0x6789 0x3015 0x4018 0x70b0 0x6813 0x6600 0x2ca4 0x3328 0x596b 0x6764 0x62b7 0x2bbe 0x3022 0x477d 0x6688 0x6215 0x2b68 0x2f70 0x4725 0x57da 0x5967 0x2b6c 0x2f09 0x3dd8 0x58e5 0x64be 0x2ab7 0x2db9 0x398d 0x5bd2 0x6460 0x2ae0 0x2ded 0x457f 0x6bcd 0x75c0 0x2cb0 0x2ff3 0x438f 0x6311 0x7110 0x2d80 0x2fa5 0x439f 0x6129 0x668d 0x2d89 0x2ebe 0x3ec3 0x61e3 0x62ca 0x2d50 0x2e6c 0x3eb4 0x5b72 0x6005 0x2d50 0x2e6c 0x3eb4 0x5b72 0x6005 0x2d50 0x2e6c 0x3eb4 0x5b72 0x6005>;
						qcom,lut-row-legend = <0x2710 0x2648 0x2580 0x24b8 0x23f0 0x2328 0x2260 0x2198 0x20d0 0x2008 0x1f40 0x1e78 0x1db0 0x1ce8 0x1c20 0x1b58 0x1a90 0x19c8 0x1900 0x1838 0x1770 0x16a8 0x15e0 0x1518 0x1450 0x1388 0x12c0 0x11f8 0x1130 0x1068 0xfa0 0xed8 0xe10 0xd48 0xc80 0xbb8 0xaf0 0xa28 0x960 0x898 0x7d0 0x708 0x640 0x578 0x4b0 0x3e8 0x384 0x320 0x2bc 0x258 0x1f4 0x190 0x12c 0xc8 0x64 0x0>;
					};

					qcom,pc-temp-z6-lut {
						qcom,lut-col-legend = <0x0 0xa 0x19 0x28 0x32>;
						qcom,lut-data = <0x409a 0x3c2e 0x39dd 0x392f 0x3913 0x416d 0x3c48 0x39ee 0x394b 0x392d 0x419b 0x3c57 0x39ee 0x3952 0x3933 0x4181 0x3c50 0x39e4 0x394f 0x3931 0x413b 0x3c33 0x39d5 0x3947 0x392a 0x40e4 0x3c0c 0x39c7 0x393d 0x3921 0x409c 0x3be5 0x39bb 0x3935 0x391b 0x4062 0x3bcb 0x39b0 0x392e 0x3915 0x4027 0x3bb9 0x39aa 0x392a 0x3910 0x3fe0 0x3ba7 0x39a7 0x3929 0x390e 0x3f9a 0x3b8a 0x39a3 0x3928 0x390c 0x3f73 0x3b64 0x399a 0x3924 0x390b 0x3f65 0x3b56 0x398e 0x391c 0x3906 0x3f55 0x3b62 0x3992 0x3919 0x3903 0x3f1e 0x3b70 0x39a4 0x3927 0x390a 0x3ec0 0x3b64 0x39ac 0x3933 0x3912 0x3e70 0x3b3f 0x3999 0x392a 0x390c 0x3e3a 0x3b22 0x3982 0x3915 0x38fe 0x3e0f 0x3b10 0x3982 0x3914 0x38fc 0x3df2 0x3b06 0x3991 0x3936 0x3915 0x3ddc 0x3b09 0x39a5 0x3953 0x3930 0x3dd2 0x3b19 0x39c1 0x3956 0x3934 0x3dd2 0x3b2e 0x39d7 0x3953 0x3934 0x3dd7 0x3b4e 0x39d6 0x394f 0x3932 0x3ddc 0x3b6d 0x39c9 0x3948 0x392b 0x3de1 0x3b75 0x39be 0x3942 0x3924 0x3de6 0x3b75 0x39b8 0x393d 0x391f 0x3dea 0x3b74 0x39b4 0x3938 0x391c 0x3dee 0x3b6e 0x39b1 0x3935 0x3919 0x3df0 0x3b64 0x39ae 0x3931 0x3916 0x3df0 0x3b5c 0x39ab 0x392e 0x3913 0x3df0 0x3b54 0x39a9 0x392b 0x3910 0x3def 0x3b4c 0x39a8 0x3928 0x390d 0x3ded 0x3b46 0x39a7 0x3928 0x390c 0x3deb 0x3b40 0x39a7 0x3929 0x390c 0x3deb 0x3b3c 0x39a6 0x392a 0x390c 0x3ded 0x3b38 0x39a4 0x392c 0x390f 0x3def 0x3b35 0x39a2 0x392d 0x3913 0x3def 0x3b35 0x39a0 0x392d 0x3914 0x3dee 0x3b36 0x399f 0x392a 0x3912 0x3deb 0x3b36 0x399e 0x3928 0x3910 0x3de2 0x3b35 0x399d 0x3927 0x3910 0x3dd8 0x3b34 0x399b 0x3927 0x390f 0x3dcd 0x3b2c 0x3997 0x3926 0x390f 0x3da1 0x3b16 0x398b 0x391d 0x3908 0x3d94 0x3b10 0x397f 0x3911 0x38f9 0x3d93 0x3b0a 0x397c 0x390a 0x38f2 0x3d8f 0x3b0c 0x3979 0x3906 0x38ec 0x3d8d 0x3b07 0x3977 0x3903 0x38ea 0x3d95 0x3b0c 0x397c 0x390d 0x38f8 0x3da1 0x3b20 0x3983 0x3914 0x38ff 0x3dbd 0x3b30 0x398c 0x3918 0x3902 0x3de0 0x3b45 0x3993 0x391d 0x3906 0x3e15 0x3b6d 0x39a2 0x3924 0x390d 0x3e15 0x3b6d 0x39a2 0x3924 0x390d 0x3e15 0x3b6d 0x39a2 0x3924 0x390d>;
						qcom,lut-row-legend = <0x2710 0x2648 0x2580 0x24b8 0x23f0 0x2328 0x2260 0x2198 0x20d0 0x2008 0x1f40 0x1e78 0x1db0 0x1ce8 0x1c20 0x1b58 0x1a90 0x19c8 0x1900 0x1838 0x1770 0x16a8 0x15e0 0x1518 0x1450 0x1388 0x12c0 0x11f8 0x1130 0x1068 0xfa0 0xed8 0xe10 0xd48 0xc80 0xbb8 0xaf0 0xa28 0x960 0x898 0x7d0 0x708 0x640 0x578 0x4b0 0x3e8 0x384 0x320 0x2bc 0x258 0x1f4 0x190 0x12c 0xc8 0x64 0x0>;
					};
				};

				qcom,mlp356477_2800mah {
					qcom,batt-id-kohm = <0x52>;
					qcom,battery-beta = <0x109a>;
					qcom,battery-therm-kohm = <0x64>;
					qcom,battery-type = "mlp356477_2800mah_averaged_MasterSlave_Mar13th2018";
					qcom,fastchg-current-ma = <0x1068>;
					qcom,fg-cc-cv-threshold-mv = <0x1126>;
					qcom,jeita-fcc-ranges = <0x0 0x96 0x88b80 0x97 0x1c2 0x401640 0x1c3 0x226 0x2450e0>;
					qcom,jeita-fv-ranges = <0x0 0x96 0x3f52f0 0x97 0x1c2 0x432380 0x1c3 0x226 0x3f52f0>;
					qcom,jeita-hard-thresholds = <0x58cd 0x181d>;
					qcom,jeita-soft-fcc-ua = <0x88b80 0x2450e0>;
					qcom,jeita-soft-fv-uv = <0x3f52f0 0x3f52f0>;
					qcom,jeita-soft-hys-thresholds = <0x4206 0x23c0>;
					qcom,jeita-soft-thresholds = <0x4621 0x20b8>;
					qcom,max-voltage-uv = <0x432380>;
					qcom,qg-batt-profile-ver = <0x64>;

					qcom,fcc1-temp-lut {
						qcom,lut-col-legend = <0x0 0xa 0x19 0x28 0x32>;
						qcom,lut-data = <0xa9b 0xae4 0xb2d 0xb52 0xb5c>;
					};

					qcom,fcc2-temp-lut {
						qcom,lut-col-legend = <0xfffffff6 0x0 0xa 0x19 0x28 0x32>;
						qcom,lut-data = <0xb30 0xb1e 0xb2c 0xb34 0xb31 0xb31>;
					};

					qcom,pc-temp-v1-lut {
						qcom,lut-col-legend = <0x0 0xa 0x19 0x28 0x32>;
						qcom,lut-data = <0xa9e6 0xaaa2 0xab24 0xab59 0xab67 0xa8eb 0xa99c 0xaa3e 0xaa7d 0xaa8b 0xa7e8 0xa8a6 0xa956 0xa99a 0xa9aa 0xa6f1 0xa7bc 0xa86b 0xa8b7 0xa8c8 0xa60a 0xa6d6 0xa77e 0xa7ce 0xa7e2 0xa52f 0xa5ef 0xa691 0xa6e2 0xa6fa 0xa467 0xa50a 0xa5a7 0xa5f9 0xa612 0xa3af 0xa42b 0xa4bf 0xa50f 0xa529 0xa2ed 0xa34f 0xa3dc 0xa427 0xa442 0xa211 0xa278 0xa2fb 0xa342 0xa35e 0xa131 0xa1a5 0xa21e 0xa260 0xa27c 0xa06d 0xa0d8 0xa146 0xa184 0xa19e 0x9fc2 0xa016 0xa072 0xa0ab 0xa0c3 0x9f10 0x9f5f 0x9fa7 0x9fd9 0x9fee 0x9e35 0x9ea5 0x9ee1 0x9f0c 0x9f1f 0x9d4d 0x9dd5 0x9e22 0x9e46 0x9e56 0x9c98 0x9d01 0x9d67 0x9d89 0x9d97 0x9c13 0x9c56 0x9cb4 0x9cd4 0x9ce2 0x9b9a 0x9bd6 0x9c10 0x9c27 0x9c34 0x9b1c 0x9b55 0x9b7f 0x9b8a 0x9b93 0x9a9f 0x9a99 0x9add 0x9aeb 0x9af3 0x9a17 0x99b1 0x99fc 0x9a25 0x9a33 0x996d 0x98ec 0x9905 0x9935 0x9947 0x98b1 0x984f 0x984f 0x9866 0x9874 0x9812 0x97cc 0x97c3 0x97cc 0x97d4 0x978a 0x9766 0x974d 0x9748 0x974c 0x971b 0x9714 0x96e4 0x96d3 0x96d4 0x96cf 0x96ca 0x9687 0x966b 0x9669 0x9694 0x9681 0x9633 0x960e 0x9609 0x9665 0x963e 0x95e5 0x95b7 0x95ad 0x9642 0x9607 0x95a1 0x956b 0x955a 0x9625 0x95d8 0x9565 0x9526 0x9510 0x9605 0x95ad 0x9531 0x94e9 0x94cc 0x95de 0x9585 0x9503 0x94b3 0x948e 0x95b9 0x9560 0x94dd 0x9486 0x945c 0x959c 0x953b 0x94b5 0x9459 0x9429 0x9581 0x951a 0x948b 0x9421 0x93e7 0x955c 0x94f2 0x945c 0x93e1 0x9398 0x9512 0x94a9 0x9418 0x9395 0x9344 0x94ae 0x943a 0x93b8 0x933a 0x92e9 0x943b 0x93c6 0x9348 0x92d1 0x9283 0x93a9 0x9351 0x92ca 0x9257 0x9206 0x930c 0x92c7 0x923c 0x91ca 0x9177 0x9261 0x9212 0x9196 0x912a 0x90da 0x91c8 0x9183 0x9109 0x90a8 0x905f 0x9164 0x9129 0x90c2 0x9060 0x9023 0x9141 0x9109 0x90a9 0x904e 0x9010 0x9124 0x90ef 0x9096 0x903f 0x9001 0x9100 0x90ce 0x907c 0x9026 0x8fe3 0x9096 0x905d 0x9015 0x8f93 0x8f2c 0x8f4a 0x8ef1 0x8ec0 0x8e2e 0x8dbf 0x8d6c 0x8d0d 0x8ced 0x8c51 0x8bdf 0x8b0d 0x8a9e 0x8a94 0x89eb 0x896d 0x87d3 0x8746 0x8760 0x869c 0x8611 0x82b4 0x81ee 0x8263 0x8168 0x80bb 0x7530 0x7530 0x7530 0x7530 0x7530>;
						qcom,lut-row-legend = <0x2710 0x2648 0x2580 0x24b8 0x23f0 0x2328 0x2260 0x2198 0x20d0 0x2008 0x1f40 0x1e78 0x1db0 0x1ce8 0x1c20 0x1b58 0x1a90 0x19c8 0x1900 0x1838 0x1770 0x16a8 0x15e0 0x1518 0x1450 0x1388 0x12c0 0x11f8 0x1130 0x1068 0xfa0 0xed8 0xe10 0xd48 0xc80 0xbb8 0xaf0 0xa28 0x960 0x898 0x7d0 0x708 0x640 0x578 0x4b0 0x3e8 0x384 0x320 0x2bc 0x258 0x1f4 0x190 0x12c 0xc8 0x64 0x0>;
					};

					qcom,pc-temp-v2-lut {
						qcom,lut-col-legend = <0xfffffff6 0x0 0xa 0x19 0x28 0x32>;
						qcom,lut-data = <0xab59 0xab4a 0xab36 0xab1d 0xaadc 0xaacd 0xa9a8 0xa9a5 0xa9fa 0xaa08 0xa9d9 0xa9cb 0xa81d 0xa838 0xa8d3 0xa900 0xa8dc 0xa8d0 0xa6bd 0xa70f 0xa7c4 0xa804 0xa7e7 0xa7dd 0xa581 0xa61e 0xa6cc 0xa715 0xa6f8 0xa6f2 0xa45b 0xa538 0xa5da 0xa629 0xa60d 0xa609 0xa330 0xa44b 0xa4e5 0xa53f 0xa525 0xa520 0xa22d 0xa35e 0xa3f4 0xa457 0xa43f 0xa439 0xa189 0xa263 0xa30b 0xa373 0xa35c 0xa356 0xa117 0xa152 0xa22b 0xa293 0xa27b 0xa275 0xa087 0xa06d 0xa151 0xa1b6 0xa19e 0xa198 0x9fbf 0x9fe0 0xa080 0xa0dd 0xa0c6 0xa0bf 0x9eca 0x9f68 0x9fb4 0xa007 0x9ff2 0x9fea 0x9d89 0x9ea3 0x9ee5 0x9f3b 0x9f26 0x9f1e 0x9c05 0x9d5c 0x9e0d 0x9e76 0x9e5d 0x9e56 0x9ae6 0x9c35 0x9d43 0x9db5 0x9d9c 0x9d96 0x9a20 0x9b83 0x9c97 0x9cf4 0x9ce4 0x9cde 0x996e 0x9aee 0x9bf0 0x9c39 0x9c31 0x9c2c 0x98ae 0x9a23 0x9b2a 0x9b8d 0x9b86 0x9b80 0x97f4 0x9910 0x9a44 0x9af0 0x9ae3 0x9ade 0x9754 0x980c 0x9960 0x9a3b 0x9a2d 0x9a2a 0x96c6 0x9741 0x9888 0x9945 0x993e 0x993e 0x9650 0x9692 0x97be 0x9846 0x984a 0x984d 0x95f2 0x9603 0x9716 0x978f 0x9799 0x979d 0x95a4 0x958a 0x9687 0x96fe 0x970d 0x9712 0x9560 0x952d 0x9606 0x9682 0x9693 0x9698 0x9526 0x94ed 0x958e 0x9613 0x9626 0x962a 0x94ef 0x94bb 0x9523 0x95b0 0x95c5 0x95c7 0x94bc 0x948e 0x94ca 0x9555 0x956a 0x956a 0x948c 0x9468 0x947c 0x9500 0x9516 0x9514 0x945a 0x9443 0x943d 0x94b2 0x94c9 0x94c6 0x9427 0x941c 0x940c 0x9469 0x9483 0x9480 0x93f3 0x93f3 0x93e1 0x9425 0x9441 0x943d 0x93bc 0x93c8 0x93b9 0x93e4 0x93fc 0x93f3 0x9383 0x939c 0x9395 0x93a9 0x93b4 0x93a3 0x9343 0x936a 0x936c 0x936a 0x9360 0x9346 0x92fe 0x9330 0x9338 0x9327 0x92f9 0x92d3 0x92b3 0x92ed 0x92f9 0x92e0 0x928f 0x925d 0x9263 0x92a1 0x92b0 0x9295 0x9236 0x91fe 0x9210 0x9248 0x9259 0x9246 0x91e8 0x91ac 0x91bc 0x91e5 0x91f3 0x91e9 0x918f 0x9150 0x9166 0x9175 0x9176 0x9176 0x911f 0x90e0 0x910d 0x90fa 0x90ed 0x90f2 0x909e 0x9060 0x90ab 0x907d 0x905d 0x9058 0x9006 0x8fcd 0x9047 0x900b 0x8ffb 0x8ffe 0x8fc7 0x8f96 0x8fd1 0x8fb8 0x8fb8 0x8fdc 0x8fb1 0x8f7e 0x8f90 0x8f92 0x8f9a 0x8fcc 0x8fa1 0x8f6f 0x8f3b 0x8f63 0x8f66 0x8fac 0x8f80 0x8f4f 0x8ebd 0x8f19 0x8f05 0x8f71 0x8f30 0x8ee5 0x8df6 0x8e78 0x8e3b 0x8ea5 0x8e1b 0x8db4 0x8cb8 0x8d35 0x8cbf 0x8d11 0x8c6a 0x8bf5 0x8af7 0x8b42 0x8a9d 0x8b00 0x8a3a 0x89ba 0x8889 0x8894 0x87d3 0x8844 0x8753 0x86c4 0x8519 0x84d7 0x83cb 0x846e 0x833e 0x82a0 0x7f87 0x7eda 0x7d90 0x7e89 0x7d19 0x7c55 0x7542 0x6d93 0x6791 0x7041 0x6ba2 0x696f>;
						qcom,lut-row-legend = <0x2710 0x2648 0x2580 0x24b8 0x23f0 0x2328 0x2260 0x2198 0x20d0 0x2008 0x1f40 0x1e78 0x1db0 0x1ce8 0x1c20 0x1b58 0x1a90 0x19c8 0x1900 0x1838 0x1770 0x16a8 0x15e0 0x1518 0x1450 0x1388 0x12c0 0x11f8 0x1130 0x1068 0xfa0 0xed8 0xe10 0xd48 0xc80 0xbb8 0xaf0 0xa28 0x960 0x898 0x7d0 0x708 0x640 0x578 0x4b0 0x3e8 0x384 0x320 0x2bc 0x258 0x1f4 0x190 0x12c 0xc8 0x64 0x0>;
					};

					qcom,pc-temp-y1-lut {
						qcom,lut-col-legend = <0xfffffff6 0x0 0xa 0x19 0x28 0x32>;
						qcom,lut-data = <0x1ef9 0x1a30 0x17a2 0x15be 0x14ca 0x1473 0x1f5c 0x1a2d 0x17a2 0x15b8 0x14c8 0x1472 0x1fa5 0x1a25 0x17a3 0x15b2 0x14c6 0x1471 0x1fd7 0x1a1c 0x17a3 0x15ac 0x14c4 0x146f 0x1ff3 0x1a14 0x17a4 0x15a7 0x14c1 0x146e 0x1ffa 0x1a11 0x17a5 0x15a4 0x14bf 0x146c 0x1fdd 0x1a0b 0x17a6 0x15a3 0x14bc 0x1469 0x1fb8 0x1a03 0x17a6 0x15a2 0x14b9 0x1466 0x1fae 0x1a07 0x17a7 0x15a0 0x14b6 0x1466 0x1fa8 0x1a25 0x17a8 0x1599 0x14b3 0x1466 0x1fa3 0x1a3d 0x17a7 0x1595 0x14b2 0x1466 0x1fb8 0x1a3c 0x17a2 0x1595 0x14b1 0x1464 0x1fd2 0x1a33 0x179c 0x1596 0x14b0 0x1461 0x1fd3 0x1a32 0x179c 0x1598 0x14af 0x1460 0x1fd3 0x1a33 0x17a1 0x159d 0x14ad 0x1461 0x1fd2 0x1a35 0x17a4 0x15a0 0x14ab 0x1461 0x1fc7 0x1a31 0x17a5 0x159e 0x14aa 0x1463 0x1fb7 0x1a2b 0x17a7 0x159c 0x14a8 0x1465 0x1fa4 0x1a2c 0x17a9 0x159c 0x14a9 0x1465 0x1f8f 0x1a34 0x17ae 0x159b 0x14aa 0x1464 0x1f86 0x1a3b 0x17b1 0x159b 0x14ac 0x1463 0x1f86 0x1a38 0x17b3 0x159c 0x14ae 0x1464 0x1f8c 0x1a32 0x17b7 0x159c 0x14b0 0x1466 0x1fb5 0x1a2f 0x17b7 0x159c 0x14b1 0x1467 0x1fea 0x1a2e 0x17b6 0x159c 0x14b2 0x1469 0x1fe7 0x1a2e 0x17b5 0x159c 0x14b3 0x146b 0x1fb6 0x1a2c 0x17b4 0x159f 0x14b5 0x146d 0x1f94 0x1a2b 0x17b1 0x15a3 0x14b9 0x1470 0x1f97 0x1a29 0x17ae 0x15a4 0x14bd 0x1474 0x1fa4 0x1a23 0x17ab 0x15a5 0x14bf 0x1478 0x1f9c 0x1a20 0x17ab 0x15a6 0x14c2 0x147b 0x1f7b 0x1a23 0x17af 0x15aa 0x14c5 0x147c 0x1f6b 0x1a27 0x17b5 0x15ae 0x14c8 0x147d 0x1f5b 0x1a25 0x17b8 0x15b1 0x14cc 0x147f 0x1f4b 0x1a15 0x17bd 0x15b4 0x14d1 0x1483 0x1f55 0x1a0b 0x17c0 0x15b6 0x14d5 0x1487 0x1f72 0x1a17 0x17c1 0x15bb 0x14d8 0x148a 0x1f92 0x1a29 0x17c2 0x15c0 0x14db 0x148d 0x1fbb 0x1a2a 0x17c5 0x15c2 0x14de 0x148f 0x1fd4 0x1a1c 0x17ce 0x15c3 0x14e4 0x1491 0x1fa5 0x1a13 0x17d5 0x15c4 0x14e8 0x1494 0x1f69 0x1a23 0x17d2 0x15cd 0x14e9 0x1497 0x1fa8 0x1a33 0x17d0 0x15d2 0x14ec 0x149b 0x1f98 0x1a30 0x17d6 0x15d2 0x14f3 0x14a2 0x1f70 0x1a34 0x17d8 0x15d9 0x14f8 0x14a4 0x1f77 0x1a45 0x17d2 0x15db 0x14fa 0x14a8 0x1f7b 0x1a44 0x17e2 0x15e1 0x14fa 0x14a8 0x1f9c 0x1a57 0x17c9 0x15de 0x1500 0x14aa 0x1fdd 0x1a5e 0x17c6 0x15e5 0x14fe 0x14ab 0x2005 0x1a42 0x17d8 0x15e9 0x1505 0x14ad 0x204d 0x1a52 0x17d9 0x15e8 0x1508 0x14ac 0x2060 0x1a67 0x17e0 0x15f8 0x1510 0x14b8 0x20bc 0x1a6e 0x17f0 0x160b 0x1518 0x14c1 0x20e6 0x1a7b 0x1805 0x1618 0x1529 0x14cc 0x20e6 0x1a7b 0x1805 0x1618 0x1529 0x14cc 0x20e6 0x1a7b 0x1805 0x1618 0x1529 0x14cc>;
						qcom,lut-row-legend = <0x2710 0x2648 0x2580 0x24b8 0x23f0 0x2328 0x2260 0x2198 0x20d0 0x2008 0x1f40 0x1e78 0x1db0 0x1ce8 0x1c20 0x1b58 0x1a90 0x19c8 0x1900 0x1838 0x1770 0x16a8 0x15e0 0x1518 0x1450 0x1388 0x12c0 0x11f8 0x1130 0x1068 0xfa0 0xed8 0xe10 0xd48 0xc80 0xbb8 0xaf0 0xa28 0x960 0x898 0x7d0 0x708 0x640 0x578 0x4b0 0x3e8 0x384 0x320 0x2bc 0x258 0x1f4 0x190 0x12c 0xc8 0x64 0x0>;
					};

					qcom,pc-temp-y2-lut {
						qcom,lut-col-legend = <0xfffffff6 0x0 0xa 0x19 0x28 0x32>;
						qcom,lut-data = <0x25b6 0x25ab 0x298f 0x2b3e 0x2b71 0x2b4e 0x25b6 0x25ab 0x29a6 0x2b30 0x2b59 0x2b32 0x25b7 0x25ab 0x29b3 0x2b1d 0x2b37 0x2b15 0x25b7 0x268f 0x29b8 0x2b06 0x2b13 0x2af9 0x25b8 0x27ce 0x29b8 0x2aec 0x2af5 0x2ae0 0x25b8 0x2855 0x29b5 0x2acf 0x2ae5 0x2ace 0x25b9 0x2844 0x29a8 0x2aa6 0x2add 0x2ac2 0x25b9 0x282a 0x2994 0x2a81 0x2ad7 0x2ab7 0x25b9 0x283d 0x2988 0x2a7b 0x2acf 0x2aa4 0x25ba 0x28c8 0x297f 0x2a7a 0x2ab5 0x2a82 0x25ba 0x2926 0x297b 0x2a7a 0x2aa7 0x2a70 0x25ba 0x28f9 0x2982 0x2a75 0x2ab8 0x2a7a 0x25bb 0x28b1 0x2993 0x2a6d 0x2ad1 0x2a88 0x25ba 0x28ad 0x29b4 0x2a68 0x2ac8 0x2a85 0x25b9 0x28f7 0x29fc 0x2a63 0x2a91 0x2a6c 0x25b9 0x2939 0x2a31 0x2a63 0x2a72 0x2a58 0x25b9 0x2954 0x2a4a 0x2a85 0x2a7c 0x2a55 0x25b9 0x2965 0x2a5b 0x2ac2 0x2a90 0x2a5d 0x25b9 0x2919 0x2a5a 0x2b0a 0x2abf 0x2a84 0x25b8 0x273a 0x2a46 0x2b6b 0x2b34 0x2ae8 0x25b8 0x25e0 0x2a39 0x2b97 0x2b70 0x2b1a 0x25b8 0x25d2 0x2a3f 0x2b79 0x2b5a 0x2b05 0x25b8 0x25cc 0x2a4a 0x2b53 0x2b3f 0x2aeb 0x25b8 0x25cb 0x2a53 0x2b4d 0x2b47 0x2b01 0x25b8 0x25cc 0x2a5e 0x2b50 0x2b71 0x2b62 0x25b7 0x25cc 0x2a60 0x2b55 0x2b92 0x2b9a 0x25b7 0x25cb 0x29bc 0x2b64 0x2ba8 0x2b9e 0x25b7 0x25c7 0x28dc 0x2b7a 0x2bbf 0x2ba0 0x25b7 0x25c4 0x299c 0x2b90 0x2bd8 0x2bae 0x25b6 0x25c1 0x2d2d 0x2baa 0x2bff 0x2bce 0x25b6 0x25be 0x2f25 0x2bb8 0x2c16 0x2be6 0x25b6 0x25bc 0x2e14 0x2bbf 0x2c2e 0x2bf9 0x25b6 0x25bb 0x2c37 0x2bc3 0x2c4a 0x2c0d 0x25b6 0x25b9 0x2ad3 0x2bc2 0x2c50 0x2c2b 0x25b6 0x25b8 0x2993 0x2bbe 0x2c38 0x2c51 0x25b6 0x25b7 0x28b7 0x2bb5 0x2c23 0x2c5f 0x25b5 0x25b6 0x279c 0x2b8c 0x2c1e 0x2c3d 0x25b5 0x25b5 0x2664 0x2b64 0x2c25 0x2c10 0x25b5 0x25b5 0x2605 0x2b5b 0x2c25 0x2c07 0x25b5 0x25b5 0x25eb 0x2b58 0x2c1a 0x2c0e 0x25b5 0x25b4 0x25dc 0x2b3f 0x2c17 0x2c0d 0x25b5 0x25b4 0x25d1 0x2adf 0x2c41 0x2bf2 0x25b5 0x25b4 0x25ca 0x2abb 0x2c5c 0x2bdf 0x25b5 0x25b4 0x25c4 0x2aa1 0x2c27 0x2bdd 0x25b5 0x25b4 0x25c0 0x2a32 0x2bf5 0x2b7f 0x25b5 0x25b4 0x25bf 0x2a57 0x2bac 0x2b24 0x25b5 0x25b4 0x25bd 0x2a50 0x2b8a 0x2b01 0x25b4 0x25b4 0x25bc 0x2a3b 0x2b61 0x2ad2 0x25b4 0x25b3 0x25bb 0x2a2a 0x2b35 0x2ad5 0x25b3 0x25b3 0x25ba 0x2a0c 0x2b2d 0x2aba 0x25b2 0x25b3 0x25ba 0x29d7 0x2ae5 0x2a77 0x25b2 0x25b3 0x25b8 0x299b 0x2aaf 0x2a4d 0x25b1 0x25b3 0x25b6 0x2962 0x2a63 0x29fb 0x25b0 0x25b3 0x25b6 0x2923 0x2a2e 0x29a3 0x25b0 0x25b3 0x25b6 0x2923 0x2a2e 0x29a3 0x25b0 0x25b3 0x25b6 0x2923 0x2a2e 0x29a3>;
						qcom,lut-row-legend = <0x2710 0x2648 0x2580 0x24b8 0x23f0 0x2328 0x2260 0x2198 0x20d0 0x2008 0x1f40 0x1e78 0x1db0 0x1ce8 0x1c20 0x1b58 0x1a90 0x19c8 0x1900 0x1838 0x1770 0x16a8 0x15e0 0x1518 0x1450 0x1388 0x12c0 0x11f8 0x1130 0x1068 0xfa0 0xed8 0xe10 0xd48 0xc80 0xbb8 0xaf0 0xa28 0x960 0x898 0x7d0 0x708 0x640 0x578 0x4b0 0x3e8 0x384 0x320 0x2bc 0x258 0x1f4 0x190 0x12c 0xc8 0x64 0x0>;
					};

					qcom,pc-temp-y3-lut {
						qcom,lut-col-legend = <0xfffffff6 0x0 0xa 0x19 0x28 0x32>;
						qcom,lut-data = <0x38a5 0x356d 0x344e 0x33fd 0x33f5 0x33df 0x384c 0x3559 0x3451 0x33fd 0x33ee 0x33df 0x37f8 0x3542 0x3455 0x33ff 0x33e9 0x33df 0x37a9 0x352c 0x3458 0x3400 0x33e5 0x33df 0x3763 0x351c 0x345b 0x3402 0x33e3 0x33df 0x3725 0x3516 0x345e 0x3403 0x33e2 0x33df 0x36ef 0x351a 0x3460 0x3403 0x33e3 0x33e0 0x36c1 0x3520 0x3462 0x3404 0x33e6 0x33e1 0x3698 0x351a 0x3464 0x3405 0x33e7 0x33e2 0x3673 0x34ec 0x3468 0x3407 0x33e7 0x33e2 0x3669 0x34cb 0x346b 0x3409 0x33e7 0x33e2 0x3685 0x34c9 0x346d 0x340a 0x33e9 0x33e2 0x36a2 0x34c8 0x346f 0x340b 0x33eb 0x33e2 0x3679 0x34c5 0x346e 0x340d 0x33eb 0x33e3 0x3613 0x34c0 0x3466 0x3410 0x33eb 0x33e4 0x35eb 0x34b9 0x345f 0x3411 0x33eb 0x33e6 0x35e5 0x34b0 0x3459 0x3410 0x33ec 0x33e7 0x35e1 0x34a6 0x3453 0x340d 0x33ee 0x33e8 0x35dc 0x349e 0x344b 0x340c 0x33f1 0x33ea 0x35d7 0x3499 0x3440 0x340b 0x33f5 0x33ee 0x35d7 0x3492 0x3437 0x340a 0x33f7 0x33f0 0x35dc 0x3474 0x3430 0x3403 0x33f1 0x33ea 0x35e4 0x3448 0x342a 0x33fa 0x33e7 0x33e1 0x35f6 0x3432 0x3425 0x33f7 0x33e3 0x33de 0x3613 0x3425 0x3422 0x33f4 0x33e1 0x33dd 0x3632 0x3420 0x341d 0x33f3 0x33e0 0x33dd 0x3656 0x3427 0x33fc 0x33f3 0x33e0 0x33dd 0x3680 0x3439 0x33d2 0x33f3 0x33e2 0x33dd 0x36af 0x344f 0x33cb 0x33f2 0x33e2 0x33dd 0x36e4 0x346e 0x33cb 0x33f3 0x33e3 0x33dd 0x371e 0x3494 0x33ca 0x33f3 0x33e3 0x33dd 0x375e 0x34bf 0x33ca 0x33f2 0x33e3 0x33dd 0x37a3 0x34f2 0x33cb 0x33f2 0x33e3 0x33dd 0x37ee 0x352f 0x33cf 0x33f2 0x33e3 0x33dd 0x383e 0x357a 0x33e5 0x33f3 0x33e3 0x33de 0x3891 0x35d1 0x33f6 0x33f3 0x33e3 0x33de 0x38e8 0x3637 0x33ee 0x33f0 0x33e1 0x33dd 0x3942 0x36ac 0x33e1 0x33ec 0x33df 0x33dc 0x399e 0x3726 0x33e2 0x33ec 0x33de 0x33dc 0x3a02 0x37a7 0x33f3 0x33ec 0x33dd 0x33dd 0x3a73 0x3829 0x3407 0x33ed 0x33dd 0x33dd 0x3aea 0x38a6 0x341f 0x33ef 0x33dd 0x33de 0x3b5e 0x3920 0x3438 0x33f2 0x33dd 0x33de 0x3bc6 0x3991 0x345a 0x33f7 0x33de 0x33dc 0x3ba0 0x39e8 0x349e 0x33f8 0x33e0 0x33de 0x3c4f 0x39d1 0x34a4 0x33fb 0x33e4 0x33e0 0x3cc5 0x39e8 0x34cd 0x3404 0x33eb 0x33e6 0x3da7 0x3a2a 0x34f8 0x3407 0x33ec 0x33e7 0x3eba 0x3a71 0x3527 0x3414 0x33ef 0x33e7 0x4027 0x3aad 0x3561 0x3414 0x33ec 0x33e6 0x4227 0x3af7 0x3587 0x3415 0x33ee 0x33e6 0x4525 0x3b6f 0x35d3 0x341d 0x33f0 0x33e9 0x499f 0x3c16 0x366e 0x3426 0x33f3 0x33ec 0x509c 0x3cd3 0x373f 0x343a 0x33fc 0x33f3 0x509c 0x3cd3 0x373f 0x343a 0x33fc 0x33f3 0x509c 0x3cd3 0x373f 0x343a 0x33fc 0x33f3>;
						qcom,lut-row-legend = <0x2710 0x2648 0x2580 0x24b8 0x23f0 0x2328 0x2260 0x2198 0x20d0 0x2008 0x1f40 0x1e78 0x1db0 0x1ce8 0x1c20 0x1b58 0x1a90 0x19c8 0x1900 0x1838 0x1770 0x16a8 0x15e0 0x1518 0x1450 0x1388 0x12c0 0x11f8 0x1130 0x1068 0xfa0 0xed8 0xe10 0xd48 0xc80 0xbb8 0xaf0 0xa28 0x960 0x898 0x7d0 0x708 0x640 0x578 0x4b0 0x3e8 0x384 0x320 0x2bc 0x258 0x1f4 0x190 0x12c 0xc8 0x64 0x0>;
					};

					qcom,pc-temp-y4-lut {
						qcom,lut-col-legend = <0xfffffff6 0x0 0xa 0x19 0x28 0x32>;
						qcom,lut-data = <0x4428 0x4399 0x419e 0x40e2 0x4063 0x4056 0x4470 0x43b2 0x41de 0x40e2 0x4066 0x4055 0x44c1 0x43e2 0x4226 0x40e1 0x4069 0x4054 0x450f 0x4419 0x4269 0x40e0 0x406b 0x4053 0x4550 0x4447 0x429b 0x40df 0x406d 0x4053 0x4577 0x445d 0x42ae 0x40dd 0x406d 0x4052 0x4586 0x445f 0x42a3 0x40db 0x406d 0x4052 0x4595 0x4460 0x4291 0x40d9 0x406c 0x4052 0x45fe 0x4467 0x4286 0x40d7 0x406d 0x4052 0x4704 0x448e 0x427f 0x40d7 0x4071 0x4056 0x4767 0x44c8 0x427c 0x40d7 0x4074 0x4059 0x46e4 0x454e 0x428a 0x40da 0x4076 0x405e 0x4619 0x45ee 0x42a6 0x40e1 0x407a 0x4063 0x4548 0x45d4 0x42be 0x40eb 0x4080 0x4067 0x4462 0x448b 0x42d6 0x40fe 0x408b 0x406c 0x43f7 0x43a8 0x42ee 0x4113 0x4097 0x4072 0x43d3 0x43c0 0x4309 0x4127 0x40a2 0x407a 0x43b0 0x43ea 0x431f 0x413f 0x40b0 0x4086 0x4372 0x43da 0x4312 0x416c 0x40ca 0x4099 0x4329 0x4340 0x42b8 0x41b5 0x40f6 0x40b9 0x42f5 0x42a4 0x424e 0x41d4 0x410b 0x40c9 0x42cc 0x424e 0x41e1 0x4172 0x40da 0x40a8 0x42b5 0x420c 0x4179 0x40e8 0x4091 0x4076 0x42ae 0x41e9 0x413f 0x40b7 0x4076 0x4063 0x42aa 0x41d3 0x4116 0x409f 0x4069 0x4059 0x42aa 0x41c9 0x4107 0x4097 0x4065 0x4055 0x42aa 0x41c9 0x4129 0x4097 0x4065 0x4056 0x42ab 0x41ca 0x4157 0x4097 0x4067 0x4057 0x42ae 0x41cb 0x415c 0x4099 0x4069 0x405a 0x42b2 0x41cc 0x4151 0x409f 0x4071 0x4062 0x42b7 0x41cd 0x414c 0x40a5 0x407b 0x406b 0x42c0 0x41d4 0x4151 0x40aa 0x4089 0x4078 0x42c7 0x41e2 0x415a 0x40ae 0x4097 0x4083 0x42cb 0x41ef 0x415c 0x40ac 0x409c 0x4086 0x42cf 0x41fd 0x414a 0x40a5 0x409c 0x4083 0x42d7 0x420a 0x4140 0x409c 0x4096 0x407d 0x42e4 0x4218 0x415f 0x4090 0x4079 0x406c 0x42ee 0x4224 0x4190 0x4085 0x405d 0x405b 0x42f6 0x422d 0x41a5 0x4085 0x405c 0x4057 0x42fd 0x4233 0x41af 0x408a 0x405f 0x4055 0x4305 0x4236 0x41b2 0x4092 0x4061 0x4055 0x430f 0x4234 0x41b2 0x40a0 0x4062 0x4055 0x4323 0x4231 0x41b1 0x40ab 0x4061 0x4053 0x4338 0x4233 0x41af 0x40b1 0x4057 0x4046 0x42f4 0x4245 0x41ba 0x40bf 0x405d 0x4048 0x4318 0x4241 0x41d1 0x40c8 0x406d 0x405d 0x4332 0x4251 0x41fd 0x40de 0x4077 0x406f 0x4381 0x4296 0x423a 0x40fb 0x4090 0x4093 0x43ee 0x42d3 0x4281 0x4127 0x40ad 0x4094 0x4474 0x42eb 0x429e 0x412a 0x4083 0x406d 0x451a 0x42cd 0x428e 0x4121 0x408f 0x4072 0x463a 0x42a4 0x429b 0x4148 0x40a4 0x4082 0x4891 0x42a7 0x42e4 0x417c 0x40cc 0x40aa 0x4ebc 0x42ef 0x4367 0x41ef 0x4157 0x414f 0x4ebc 0x42ef 0x4367 0x41ef 0x4157 0x414f 0x4ebc 0x42ef 0x4367 0x41ef 0x4157 0x414f>;
						qcom,lut-row-legend = <0x2710 0x2648 0x2580 0x24b8 0x23f0 0x2328 0x2260 0x2198 0x20d0 0x2008 0x1f40 0x1e78 0x1db0 0x1ce8 0x1c20 0x1b58 0x1a90 0x19c8 0x1900 0x1838 0x1770 0x16a8 0x15e0 0x1518 0x1450 0x1388 0x12c0 0x11f8 0x1130 0x1068 0xfa0 0xed8 0xe10 0xd48 0xc80 0xbb8 0xaf0 0xa28 0x960 0x898 0x7d0 0x708 0x640 0x578 0x4b0 0x3e8 0x384 0x320 0x2bc 0x258 0x1f4 0x190 0x12c 0xc8 0x64 0x0>;
					};

					qcom,pc-temp-y5-lut {
						qcom,lut-col-legend = <0xfffffff6 0x0 0xa 0x19 0x28 0x32>;
						qcom,lut-data = <0x272e 0x2208 0x378f 0x39b6 0x4de7 0x3fb4 0x28d0 0x22b8 0x380d 0x3b2c 0x48eb 0x3ddb 0x2a2a 0x2942 0x38be 0x3c05 0x4271 0x3c61 0x2b2e 0x2fac 0x3979 0x3c6a 0x3bf9 0x3b48 0x2bce 0x350b 0x3a13 0x3c81 0x3706 0x3a95 0x2bfc 0x3874 0x3a64 0x3c70 0x3519 0x3a48 0x2b87 0x3a64 0x3a7d 0x3be7 0x35e8 0x3a9b 0x2af9 0x3ba6 0x3a8a 0x3b2f 0x372b 0x3b28 0x2b8f 0x3ab4 0x3a8a 0x3afa 0x3726 0x3aef 0x2e4a 0x343a 0x3a7d 0x3ad0 0x3602 0x397c 0x3247 0x2fd6 0x3a52 0x3a82 0x3560 0x37eb 0x3b54 0x3429 0x37cf 0x3997 0x35dc 0x3689 0x42cc 0x3b3b 0x344a 0x383e 0x362e 0x3542 0x3daa 0x3c87 0x3416 0x36fe 0x354b 0x34aa 0x3097 0x3b5d 0x361d 0x35ac 0x3387 0x34ed 0x2c8e 0x3a91 0x380a 0x34b9 0x3257 0x3546 0x2d1b 0x3c53 0x3950 0x3397 0x31f9 0x34ea 0x2d8e 0x3f3f 0x3a9e 0x327b 0x31fc 0x346f 0x2d36 0x3f0a 0x3c39 0x32cc 0x32c9 0x34ec 0x2c64 0x3974 0x3e7a 0x3556 0x3501 0x36d1 0x2bad 0x33e4 0x4023 0x3862 0x3771 0x3868 0x2aea 0x3137 0x411e 0x3c83 0x3a39 0x39ea 0x2a53 0x2f24 0x41c0 0x4031 0x3cb5 0x3b38 0x29ee 0x2d18 0x41bb 0x4104 0x3d22 0x3b5c 0x29aa 0x2ad2 0x412a 0x40cf 0x3bca 0x3bf2 0x299f 0x299f 0x4006 0x40ee 0x3ac8 0x3c72 0x299e 0x2998 0x3805 0x40d5 0x3bbd 0x3c86 0x299e 0x2995 0x2dd0 0x409c 0x3d80 0x3c70 0x29c1 0x29a9 0x2b94 0x40c2 0x3df9 0x3b7d 0x29ee 0x2a32 0x2b18 0x4137 0x3d85 0x3947 0x29f9 0x2ac2 0x2acf 0x4174 0x3cf7 0x3810 0x2a0d 0x2b09 0x2a95 0x41bf 0x3c8e 0x37d2 0x2a2d 0x2b44 0x2a71 0x423f 0x3c28 0x37e7 0x2a82 0x2ba9 0x2b2e 0x43d3 0x3d59 0x3949 0x2ac9 0x2c67 0x2fa4 0x46b1 0x40bd 0x3d7c 0x2abc 0x2d00 0x32d3 0x4786 0x4217 0x4028 0x2a91 0x2d40 0x30d0 0x4375 0x40ec 0x3ff8 0x2a6f 0x2d6b 0x2d52 0x3e2a 0x3edb 0x3f57 0x2a53 0x2d6e 0x2cde 0x3b6d 0x3c58 0x3fc7 0x2a44 0x2d4b 0x2da1 0x396c 0x3964 0x409f 0x2a73 0x2d32 0x2e0b 0x37fa 0x381d 0x40a6 0x2acb 0x2d3b 0x2e15 0x3719 0x37a3 0x3f83 0x2b16 0x2d4c 0x2e02 0x378b 0x3781 0x3fda 0x2b15 0x2cf5 0x2d7f 0x3913 0x3ad2 0x41fd 0x2b24 0x2c43 0x2e03 0x3776 0x3a22 0x3ffe 0x2b87 0x2c7c 0x2cf4 0x374c 0x3a22 0x38fd 0x2c39 0x2ce0 0x2d86 0x390b 0x3e8c 0x3f0e 0x2c5c 0x2ce5 0x2d8e 0x36b1 0x3ac0 0x3a70 0x2bc6 0x2d5d 0x2ea3 0x3a46 0x3c27 0x39ec 0x2ab4 0x2de3 0x31b6 0x3c4f 0x42c5 0x43af 0x292b 0x2d91 0x316f 0x3e6d 0x4559 0x4367 0x2817 0x2d41 0x2ff8 0x3fa0 0x45d9 0x4628 0x270a 0x2cc3 0x2f56 0x3f0d 0x441c 0x4718 0x25c4 0x2e2a 0x2e9c 0x3eda 0x43c8 0x45a1 0x25c4 0x2e2a 0x2e9c 0x3eda 0x43c8 0x45a1 0x25c4 0x2e2a 0x2e9c 0x3eda 0x43c8 0x45a1>;
						qcom,lut-row-legend = <0x2710 0x2648 0x2580 0x24b8 0x23f0 0x2328 0x2260 0x2198 0x20d0 0x2008 0x1f40 0x1e78 0x1db0 0x1ce8 0x1c20 0x1b58 0x1a90 0x19c8 0x1900 0x1838 0x1770 0x16a8 0x15e0 0x1518 0x1450 0x1388 0x12c0 0x11f8 0x1130 0x1068 0xfa0 0xed8 0xe10 0xd48 0xc80 0xbb8 0xaf0 0xa28 0x960 0x898 0x7d0 0x708 0x640 0x578 0x4b0 0x3e8 0x384 0x320 0x2bc 0x258 0x1f4 0x190 0x12c 0xc8 0x64 0x0>;
					};

					qcom,pc-temp-y6-lut {
						qcom,lut-col-legend = <0xfffffff6 0x0 0xa 0x19 0x28 0x32>;
						qcom,lut-data = <0x1d2b 0x17f4 0x15a2 0x1426 0x13bf 0x13a3 0x1cfa 0x1820 0x15ae 0x1426 0x13bd 0x13a2 0x1ccb 0x183d 0x15b5 0x1426 0x13ba 0x13a1 0x1c9e 0x184f 0x15b9 0x1425 0x13b8 0x13a1 0x1c73 0x1858 0x15ba 0x1424 0x13b6 0x13a1 0x1c4a 0x185a 0x15ba 0x1422 0x13b6 0x13a1 0x1c1a 0x1853 0x15b3 0x1420 0x13b6 0x13a1 0x1bf7 0x1843 0x15a4 0x141e 0x13b7 0x13a2 0x1bff 0x182f 0x159b 0x141d 0x13b7 0x13a3 0x1c22 0x1811 0x1592 0x141d 0x13b8 0x13a4 0x1c30 0x1800 0x158f 0x141d 0x13b9 0x13a5 0x1c1b 0x181a 0x1590 0x141e 0x13bb 0x13a6 0x1bf3 0x1846 0x1592 0x141f 0x13bd 0x13a7 0x1ba3 0x183f 0x1593 0x1422 0x13bf 0x13a9 0x1b29 0x17e7 0x1593 0x1428 0x13c2 0x13ab 0x1af3 0x17aa 0x1592 0x142f 0x13c5 0x13ae 0x1ae4 0x17ac 0x1594 0x1434 0x13c9 0x13b1 0x1ad8 0x17b1 0x1597 0x1439 0x13ce 0x13b5 0x1ac5 0x17a6 0x1591 0x1444 0x13d7 0x13bc 0x1ab2 0x1762 0x156f 0x1458 0x13e7 0x13c8 0x1aac 0x1723 0x1549 0x1460 0x13ee 0x13ce 0x1aaa 0x1704 0x1525 0x1440 0x13db 0x13c0 0x1aa9 0x16ef 0x1505 0x1412 0x13c0 0x13ab 0x1ab7 0x16ec 0x14f5 0x1402 0x13b5 0x13a4 0x1ad3 0x16f0 0x14eb 0x13fa 0x13b0 0x13a0 0x1aed 0x16f6 0x14e5 0x13f7 0x13ae 0x139f 0x1b0b 0x1707 0x14df 0x13f8 0x13af 0x139f 0x1b2c 0x1726 0x14db 0x13f9 0x13b0 0x13a0 0x1b4f 0x1748 0x14db 0x13fb 0x13b2 0x13a2 0x1b76 0x176f 0x14de 0x13fe 0x13b5 0x13a4 0x1ba2 0x179c 0x14e2 0x1401 0x13b8 0x13a7 0x1bd2 0x17d0 0x14ea 0x1404 0x13bd 0x13aa 0x1c07 0x180c 0x14f7 0x1406 0x13c1 0x13ae 0x1c40 0x184e 0x1507 0x1407 0x13c3 0x13af 0x1c7d 0x1899 0x151d 0x1407 0x13c4 0x13af 0x1cbd 0x18ec 0x1536 0x1407 0x13c2 0x13ae 0x1d01 0x1946 0x1552 0x1404 0x13b9 0x13a8 0x1d47 0x19a8 0x1573 0x1400 0x13b1 0x13a3 0x1d8f 0x1a0b 0x159a 0x1401 0x13b0 0x13a3 0x1ddb 0x1a70 0x15cb 0x1407 0x13b1 0x13a3 0x1e2f 0x1ad3 0x1600 0x140d 0x13b2 0x13a4 0x1e88 0x1b33 0x1639 0x1418 0x13b4 0x13a4 0x1ee4 0x1b8d 0x1677 0x1423 0x13b4 0x13a4 0x1f3a 0x1bdf 0x16b9 0x142f 0x13b3 0x13a0 0x1f17 0x1c26 0x1711 0x143d 0x13b6 0x13a2 0x1fa0 0x1c18 0x1721 0x1444 0x13c0 0x13aa 0x2003 0x1c2e 0x1758 0x1455 0x13c7 0x13b4 0x20dc 0x1c70 0x1792 0x1463 0x13d0 0x13bf 0x21e6 0x1cb6 0x17d0 0x1480 0x13db 0x13bf 0x2347 0x1ced 0x180b 0x1484 0x13cd 0x13b3 0x2531 0x1d1e 0x1834 0x1489 0x13d2 0x13b6 0x280b 0x1d6f 0x188a 0x14a5 0x13dc 0x13bd 0x2c58 0x1df2 0x192a 0x14c8 0x13ec 0x13cd 0x3313 0x1ea6 0x19f6 0x1509 0x141c 0x1403 0x3313 0x1ea6 0x19f6 0x1509 0x141c 0x1403 0x3313 0x1ea6 0x19f6 0x1509 0x141c 0x1403>;
						qcom,lut-row-legend = <0x2710 0x2648 0x2580 0x24b8 0x23f0 0x2328 0x2260 0x2198 0x20d0 0x2008 0x1f40 0x1e78 0x1db0 0x1ce8 0x1c20 0x1b58 0x1a90 0x19c8 0x1900 0x1838 0x1770 0x16a8 0x15e0 0x1518 0x1450 0x1388 0x12c0 0x11f8 0x1130 0x1068 0xfa0 0xed8 0xe10 0xd48 0xc80 0xbb8 0xaf0 0xa28 0x960 0x898 0x7d0 0x708 0x640 0x578 0x4b0 0x3e8 0x384 0x320 0x2bc 0x258 0x1f4 0x190 0x12c 0xc8 0x64 0x0>;
					};

					qcom,pc-temp-z1-lut {
						qcom,lut-col-legend = <0x0 0xa 0x19 0x28 0x32>;
						qcom,lut-data = <0x386a 0x33bb 0x3033 0x2ecb 0x2e3f 0x384b 0x33a2 0x3028 0x2e8c 0x2dfd 0x3838 0x338f 0x3006 0x2e75 0x2dec 0x3830 0x337c 0x2ff1 0x2e67 0x2de1 0x382d 0x3376 0x2fe7 0x2e5e 0x2dda 0x3829 0x337b 0x2fe1 0x2e57 0x2dd7 0x3821 0x337e 0x2fdd 0x2e52 0x2dd3 0x3816 0x3377 0x2fda 0x2e4b 0x2dce 0x380d 0x3366 0x2fd8 0x2e47 0x2dca 0x3803 0x335a 0x2fd2 0x2e45 0x2dc8 0x37fc 0x3357 0x2fcd 0x2e45 0x2dc7 0x37f7 0x3358 0x2fcd 0x2e44 0x2dc6 0x37f1 0x3356 0x2fce 0x2e40 0x2dc4 0x37e9 0x334f 0x2fca 0x2e3d 0x2dc3 0x37e2 0x3348 0x2fbe 0x2e3b 0x2dc2 0x37db 0x3340 0x2fb7 0x2e3a 0x2dc2 0x37d5 0x3339 0x2fb3 0x2e39 0x2dc1 0x37d5 0x3337 0x2fab 0x2e36 0x2dc2 0x37d9 0x333f 0x2faa 0x2e34 0x2dc3 0x37e0 0x3349 0x2fb2 0x2e37 0x2dc4 0x37e8 0x334d 0x2fb7 0x2e3d 0x2dc6 0x37ee 0x334a 0x2fbd 0x2e41 0x2dc9 0x37ef 0x3345 0x2fc6 0x2e43 0x2dce 0x37f0 0x334f 0x2fca 0x2e46 0x2dd2 0x37f4 0x335f 0x2fcc 0x2e4c 0x2dd6 0x3804 0x3366 0x2fce 0x2e54 0x2dd9 0x3816 0x336d 0x2fd7 0x2e59 0x2ddd 0x3825 0x336f 0x2fe2 0x2e5e 0x2de3 0x3835 0x336d 0x2fe4 0x2e61 0x2de8 0x383a 0x336f 0x2fe2 0x2e65 0x2ded 0x3825 0x3371 0x2fe0 0x2e68 0x2df0 0x37fe 0x3370 0x2fdd 0x2e6e 0x2df4 0x37f1 0x336f 0x2fd7 0x2e74 0x2df8 0x380c 0x3372 0x2fd8 0x2e79 0x2dfc 0x382a 0x3379 0x2fe4 0x2e7d 0x2e02 0x3823 0x337e 0x2fef 0x2e81 0x2e07 0x3807 0x3384 0x2ff5 0x2e86 0x2e0c 0x37fb 0x338a 0x2ffb 0x2e8d 0x2e10 0x380a 0x3395 0x3002 0x2e94 0x2e15 0x3821 0x33a3 0x300c 0x2e9b 0x2e1b 0x3835 0x33ac 0x3013 0x2ea1 0x2e21 0x384c 0x33b5 0x3017 0x2ea5 0x2e27 0x384a 0x33bd 0x301b 0x2ea9 0x2e2c 0x381f 0x33cb 0x301b 0x2ead 0x2e2f 0x385d 0x33b7 0x3017 0x2eb2 0x2e30 0x3868 0x33bb 0x302d 0x2eb7 0x2e36 0x3874 0x33b9 0x3020 0x2eb9 0x2e34 0x386b 0x33bb 0x3029 0x2ebc 0x2e37 0x3894 0x33b9 0x302c 0x2ec0 0x2e3c 0x3870 0x33cf 0x3037 0x2ec9 0x2e45 0x3889 0x33ed 0x303a 0x2ed4 0x2e50 0x38a5 0x33f4 0x3045 0x2ee0 0x2e58 0x38b9 0x3415 0x3056 0x2eef 0x2e67 0x390b 0x343d 0x3084 0x2f02 0x2e79 0x390b 0x343d 0x3084 0x2f02 0x2e79 0x390b 0x343d 0x3084 0x2f02 0x2e79>;
						qcom,lut-row-legend = <0x2710 0x2648 0x2580 0x24b8 0x23f0 0x2328 0x2260 0x2198 0x20d0 0x2008 0x1f40 0x1e78 0x1db0 0x1ce8 0x1c20 0x1b58 0x1a90 0x19c8 0x1900 0x1838 0x1770 0x16a8 0x15e0 0x1518 0x1450 0x1388 0x12c0 0x11f8 0x1130 0x1068 0xfa0 0xed8 0xe10 0xd48 0xc80 0xbb8 0xaf0 0xa28 0x960 0x898 0x7d0 0x708 0x640 0x578 0x4b0 0x3e8 0x384 0x320 0x2bc 0x258 0x1f4 0x190 0x12c 0xc8 0x64 0x0>;
					};

					qcom,pc-temp-z2-lut {
						qcom,lut-col-legend = <0x0 0xa 0x19 0x28 0x32>;
						qcom,lut-data = <0x236e 0x2bcd 0x2818 0x286d 0x283b 0x24bb 0x27e3 0x2824 0x2892 0x2849 0x2662 0x2784 0x2866 0x28be 0x2852 0x26ff 0x2782 0x287a 0x28cf 0x286e 0x26fa 0x2783 0x2880 0x28c5 0x2866 0x26ef 0x2788 0x2884 0x28a7 0x282a 0x2676 0x278e 0x2883 0x2899 0x27fd 0x253e 0x2794 0x2880 0x2894 0x27e9 0x249c 0x2799 0x287d 0x288e 0x27de 0x2566 0x279d 0x287d 0x288a 0x27e0 0x2691 0x279f 0x287d 0x2892 0x27e8 0x26d4 0x27a1 0x2875 0x2890 0x27f7 0x26b4 0x27a3 0x286a 0x2882 0x2821 0x26a2 0x27a4 0x2868 0x2875 0x2846 0x2688 0x27a5 0x2870 0x2871 0x2855 0x2615 0x27a3 0x2872 0x2871 0x2860 0x25f2 0x27a0 0x286b 0x2873 0x2866 0x2755 0x27a2 0x2867 0x2878 0x2867 0x2922 0x27ac 0x2868 0x287e 0x2868 0x298d 0x27b6 0x2867 0x288a 0x2871 0x2987 0x27aa 0x2868 0x289c 0x287b 0x296d 0x2787 0x2886 0x28a5 0x2878 0x2898 0x2777 0x28af 0x28ac 0x2856 0x274d 0x2786 0x28ae 0x28ae 0x2836 0x26e6 0x2797 0x2883 0x28a2 0x281a 0x26ea 0x2794 0x2863 0x2893 0x2801 0x26f0 0x2785 0x285f 0x2889 0x2801 0x26f3 0x277b 0x2861 0x2878 0x280d 0x26f7 0x277d 0x2866 0x2871 0x281e 0x26f9 0x2780 0x286f 0x2885 0x283b 0x267f 0x2784 0x2877 0x289d 0x285a 0x259c 0x278b 0x287a 0x289e 0x2867 0x255b 0x2793 0x287d 0x2895 0x286d 0x257d 0x279f 0x2882 0x2898 0x287e 0x25af 0x27af 0x288b 0x28cb 0x28af 0x25f2 0x27b6 0x2895 0x2903 0x28e0 0x2651 0x27b9 0x289d 0x2918 0x28f6 0x2674 0x27bc 0x28a5 0x2925 0x290f 0x261c 0x27ca 0x28c0 0x2934 0x2923 0x259f 0x27e4 0x2909 0x295a 0x2943 0x2545 0x27f1 0x2937 0x297d 0x295b 0x24e5 0x27b1 0x292a 0x298d 0x292c 0x24a2 0x27a0 0x291f 0x2996 0x28e4 0x2477 0x2852 0x292b 0x2973 0x28ff 0x2435 0x3442 0x293a 0x2983 0x28fb 0x2402 0x3819 0x28eb 0x2985 0x2926 0x2404 0x39ca 0x28e5 0x2992 0x295c 0x23fc 0x3ade 0x2900 0x299b 0x295a 0x23e4 0x35d9 0x28e5 0x29f3 0x2997 0x23d2 0x33a3 0x297e 0x29c6 0x28da 0x23bf 0x316c 0x299f 0x293d 0x2855 0x23af 0x2fcc 0x2972 0x28ff 0x2820 0x239c 0x2d7c 0x2900 0x28c0 0x27d3 0x2379 0x2b13 0x28d8 0x283c 0x279b 0x2379 0x2b13 0x28d8 0x283c 0x279b 0x2379 0x2b13 0x28d8 0x283c 0x279b>;
						qcom,lut-row-legend = <0x2710 0x2648 0x2580 0x24b8 0x23f0 0x2328 0x2260 0x2198 0x20d0 0x2008 0x1f40 0x1e78 0x1db0 0x1ce8 0x1c20 0x1b58 0x1a90 0x19c8 0x1900 0x1838 0x1770 0x16a8 0x15e0 0x1518 0x1450 0x1388 0x12c0 0x11f8 0x1130 0x1068 0xfa0 0xed8 0xe10 0xd48 0xc80 0xbb8 0xaf0 0xa28 0x960 0x898 0x7d0 0x708 0x640 0x578 0x4b0 0x3e8 0x384 0x320 0x2bc 0x258 0x1f4 0x190 0x12c 0xc8 0x64 0x0>;
					};

					qcom,pc-temp-z3-lut {
						qcom,lut-col-legend = <0x0 0xa 0x19 0x28 0x32>;
						qcom,lut-data = <0x4b6c 0x4b3a 0x4ba7 0x4ba9 0x4b91 0x4c6f 0x4c9b 0x4c07 0x4bc3 0x4baa 0x4d8a 0x4cf9 0x4c38 0x4bd3 0x4bb5 0x4dff 0x4d1c 0x4c40 0x4bd8 0x4bb9 0x4e13 0x4d25 0x4c3b 0x4bd6 0x4bb8 0x4e1c 0x4d17 0x4c33 0x4bcd 0x4bb3 0x4d94 0x4d01 0x4c2b 0x4bc8 0x4bad 0x4c1c 0x4cf2 0x4c24 0x4bc3 0x4ba9 0x4b58 0x4ce7 0x4c1b 0x4bbf 0x4ba5 0x4c34 0x4cdf 0x4c11 0x4bbc 0x4ba2 0x4d75 0x4cd9 0x4c0b 0x4bb6 0x4b9e 0x4d92 0x4cd3 0x4c07 0x4bb2 0x4b9d 0x4cde 0x4ccc 0x4c05 0x4bac 0x4b9b 0x4c6f 0x4cc0 0x4c05 0x4ba9 0x4b99 0x4cab 0x4cb9 0x4c07 0x4ba9 0x4b99 0x4cbf 0x4cbe 0x4c09 0x4ba8 0x4b9b 0x4c79 0x4cc6 0x4c02 0x4ba7 0x4b9b 0x4bd7 0x4cc5 0x4bf7 0x4ba6 0x4b91 0x4b44 0x4caf 0x4bf3 0x4ba5 0x4b89 0x4b3a 0x4c9d 0x4bf3 0x4ba5 0x4b89 0x4b3a 0x4ca7 0x4bf6 0x4ba6 0x4b89 0x4b3c 0x4cc4 0x4c03 0x4bae 0x4b8e 0x4bfa 0x4cd1 0x4c18 0x4bc1 0x4ba4 0x4d55 0x4cd2 0x4c26 0x4bcb 0x4bb3 0x4dcf 0x4cd3 0x4c32 0x4bca 0x4bb3 0x4dd4 0x4cd7 0x4c37 0x4bc8 0x4bb2 0x4dd7 0x4ce1 0x4c33 0x4bc8 0x4bae 0x4dd2 0x4ce6 0x4c2b 0x4bc8 0x4ba6 0x4dc2 0x4ce4 0x4c24 0x4bc7 0x4ba0 0x4db3 0x4ce0 0x4c1f 0x4bc5 0x4b9f 0x4d56 0x4cd9 0x4c1a 0x4bc1 0x4b9f 0x4cb7 0x4ccd 0x4c14 0x4bbe 0x4b9f 0x4c7b 0x4cc2 0x4c0e 0x4bba 0x4b9d 0x4c6e 0x4cbc 0x4c09 0x4bb6 0x4b9b 0x4c61 0x4cb7 0x4c04 0x4bb4 0x4b98 0x4c0c 0x4cb4 0x4c01 0x4bb2 0x4b94 0x4b74 0x4cae 0x4bff 0x4baf 0x4b92 0x4b3d 0x4ca8 0x4bfd 0x4bad 0x4b90 0x4b3e 0x4ca2 0x4bfa 0x4bab 0x4b8f 0x4b3f 0x4c99 0x4bf3 0x4ba9 0x4b91 0x4b40 0x4c78 0x4bed 0x4ba8 0x4b93 0x4b43 0x4ba7 0x4beb 0x4ba8 0x4b96 0x4b45 0x4b3d 0x4be8 0x4ba7 0x4b99 0x4b46 0x4b3c 0x4bdd 0x4ba5 0x4b99 0x4b4a 0x4b39 0x4bd5 0x4ba1 0x4b9a 0x4b4e 0x4b39 0x4ba8 0x4b9a 0x4b84 0x4b4e 0x4b39 0x4ba7 0x4b92 0x4b84 0x4b4f 0x4b39 0x4ba2 0x4b83 0x4b7b 0x4b52 0x4b39 0x4ba8 0x4b7e 0x4b7f 0x4b54 0x4b39 0x4b9a 0x4b8a 0x4b96 0x4b57 0x4b39 0x4ba1 0x4b92 0x4b94 0x4b5a 0x4b39 0x4ba8 0x4b9c 0x4b93 0x4b5f 0x4b39 0x4baa 0x4b99 0x4b9c 0x4b6c 0x4b3a 0x4bc0 0x4bb6 0x4bad 0x4b6c 0x4b3a 0x4bc0 0x4bb6 0x4bad 0x4b6c 0x4b3a 0x4bc0 0x4bb6 0x4bad>;
						qcom,lut-row-legend = <0x2710 0x2648 0x2580 0x24b8 0x23f0 0x2328 0x2260 0x2198 0x20d0 0x2008 0x1f40 0x1e78 0x1db0 0x1ce8 0x1c20 0x1b58 0x1a90 0x19c8 0x1900 0x1838 0x1770 0x16a8 0x15e0 0x1518 0x1450 0x1388 0x12c0 0x11f8 0x1130 0x1068 0xfa0 0xed8 0xe10 0xd48 0xc80 0xbb8 0xaf0 0xa28 0x960 0x898 0x7d0 0x708 0x640 0x578 0x4b0 0x3e8 0x384 0x320 0x2bc 0x258 0x1f4 0x190 0x12c 0xc8 0x64 0x0>;
					};

					qcom,pc-temp-z4-lut {
						qcom,lut-col-legend = <0x0 0xa 0x19 0x28 0x32>;
						qcom,lut-data = <0x40d6 0x3e78 0x3be9 0x3a7c 0x3a1f 0x41af 0x3ea3 0x3c1a 0x3ad3 0x3a5c 0x40b1 0x3e33 0x3bad 0x3a86 0x3a33 0x3f9b 0x3d29 0x3b45 0x3a35 0x39fa 0x3e6e 0x3c4c 0x3aea 0x3a1f 0x39e8 0x3d9e 0x3bc8 0x3aac 0x3a14 0x39e0 0x3db8 0x3b67 0x3a8c 0x3a08 0x39d9 0x3e45 0x3b32 0x3a76 0x39fb 0x39d2 0x3e85 0x3b0f 0x3a62 0x39ee 0x39ca 0x3d86 0x3af6 0x3a50 0x39e2 0x39c1 0x3c17 0x3ae4 0x3a40 0x39d7 0x39b7 0x3bd4 0x3ad7 0x3a31 0x39cd 0x39ae 0x3c49 0x3ac8 0x3a24 0x39c4 0x39a5 0x3c8d 0x3ab9 0x3a1a 0x39ba 0x399c 0x3c67 0x3ab1 0x3a12 0x39b1 0x3991 0x3c95 0x3abd 0x3a0c 0x39a8 0x3985 0x3cec 0x3ad1 0x3a04 0x399f 0x397e 0x3d3d 0x3ad0 0x39f9 0x3996 0x397b 0x3d71 0x3a9a 0x39f3 0x3992 0x3978 0x3d5c 0x3a67 0x39f0 0x3990 0x3975 0x3d44 0x3aa9 0x39f1 0x398f 0x3973 0x3d22 0x3b67 0x3a4b 0x39a4 0x397e 0x3c94 0x3bc6 0x3adc 0x39f5 0x39b9 0x3bc2 0x3bd1 0x3af3 0x3a1f 0x39de 0x3b83 0x3bd7 0x3ac0 0x3a16 0x39d9 0x3bb2 0x3bbe 0x3a8d 0x3a07 0x39d0 0x3be2 0x3b60 0x3a72 0x39f9 0x39c9 0x3bd8 0x3b1b 0x3a5f 0x39ea 0x39c3 0x3ba6 0x3b01 0x3a54 0x39de 0x39bc 0x3b80 0x3af0 0x3a4e 0x39d5 0x39b3 0x3bac 0x3ae4 0x3a4b 0x39ce 0x39a9 0x3c0d 0x3ad9 0x3a49 0x39ca 0x39a2 0x3c25 0x3ad1 0x3a48 0x39c7 0x399b 0x3c19 0x3acb 0x3a47 0x39c5 0x3996 0x3c10 0x3ac3 0x3a44 0x39c3 0x3992 0x3c46 0x3abc 0x3a42 0x39c2 0x3990 0x3cb8 0x3aa8 0x3a43 0x39ca 0x3999 0x3cd9 0x3a96 0x3a46 0x39db 0x39af 0x3cbe 0x3a8f 0x3a45 0x39e0 0x39b6 0x3ca0 0x3a8b 0x3a3d 0x39db 0x39b0 0x3c8e 0x3a96 0x3a30 0x39d3 0x39a8 0x3c83 0x3b23 0x3a19 0x39c4 0x39a0 0x3c73 0x3b6b 0x3a02 0x39b6 0x399b 0x3c55 0x3b5b 0x39fa 0x39b6 0x399e 0x3bf1 0x3b1a 0x39dd 0x39ac 0x3995 0x3bd6 0x3ae7 0x39d2 0x3990 0x3981 0x3bcc 0x3ada 0x39b9 0x3980 0x396c 0x3bc5 0x3ad1 0x39a5 0x3971 0x395c 0x3bb5 0x3ac5 0x3993 0x396a 0x394c 0x3baa 0x3acd 0x39b7 0x397d 0x3960 0x3bbe 0x3ae4 0x39be 0x397f 0x3968 0x3bcf 0x3ae8 0x39ba 0x3978 0x396d 0x3bde 0x3af3 0x39bb 0x397f 0x396d 0x3bfa 0x3b04 0x39b0 0x3972 0x396f 0x3bfa 0x3b04 0x39b0 0x3972 0x396f 0x3bfa 0x3b04 0x39b0 0x3972 0x396f>;
						qcom,lut-row-legend = <0x2710 0x2648 0x2580 0x24b8 0x23f0 0x2328 0x2260 0x2198 0x20d0 0x2008 0x1f40 0x1e78 0x1db0 0x1ce8 0x1c20 0x1b58 0x1a90 0x19c8 0x1900 0x1838 0x1770 0x16a8 0x15e0 0x1518 0x1450 0x1388 0x12c0 0x11f8 0x1130 0x1068 0xfa0 0xed8 0xe10 0xd48 0xc80 0xbb8 0xaf0 0xa28 0x960 0x898 0x7d0 0x708 0x640 0x578 0x4b0 0x3e8 0x384 0x320 0x2bc 0x258 0x1f4 0x190 0x12c 0xc8 0x64 0x0>;
					};

					qcom,pc-temp-z5-lut {
						qcom,lut-col-legend = <0x0 0xa 0x19 0x28 0x32>;
						qcom,lut-data = <0x2a0c 0x2acd 0x2f4e 0x35e2 0x3566 0x2de1 0x327d 0x3576 0x39b0 0x3a81 0x31ac 0x36ba 0x399a 0x3eb8 0x403d 0x345c 0x397e 0x3ca1 0x4168 0x43d1 0x3651 0x3bd9 0x3f34 0x4195 0x4407 0x3778 0x3e3d 0x40a1 0x40b8 0x430e 0x352b 0x4047 0x410d 0x4024 0x422c 0x2e5d 0x415a 0x4146 0x3fec 0x41c6 0x2ae2 0x41ff 0x413b 0x4011 0x417b 0x30e9 0x42a6 0x40d2 0x4012 0x4113 0x39bf 0x43a3 0x40a5 0x3fa4 0x40cb 0x3aa3 0x4463 0x4110 0x3f32 0x40fa 0x35fb 0x4452 0x41cd 0x3e83 0x4182 0x334e 0x4477 0x42cc 0x3e69 0x422f 0x35ff 0x44e6 0x4482 0x3f1f 0x441b 0x3770 0x44da 0x457a 0x4029 0x47f5 0x355c 0x444a 0x4495 0x4153 0x48c8 0x2fa2 0x43e8 0x4366 0x42eb 0x4455 0x2a7d 0x4427 0x43d6 0x4399 0x409e 0x2a2b 0x4528 0x474d 0x44c9 0x414d 0x2a38 0x49de 0x49f9 0x46bc 0x42ae 0x2a69 0x5290 0x46f7 0x45ec 0x428d 0x361a 0x5584 0x4149 0x40b9 0x4091 0x4b55 0x4df5 0x400a 0x3d5c 0x3f2e 0x526e 0x4548 0x4160 0x3cc8 0x3e86 0x51f1 0x4498 0x4322 0x3cc5 0x3dd8 0x5110 0x4682 0x4546 0x3de5 0x3d9d 0x4f30 0x4905 0x47ff 0x40b7 0x3d5c 0x4bd5 0x4cf9 0x4abc 0x4389 0x3d5b 0x4954 0x5107 0x4dd7 0x4627 0x3f36 0x43ea 0x522a 0x5065 0x48b3 0x4247 0x3bdf 0x5243 0x521a 0x4aeb 0x44d4 0x3927 0x522a 0x536b 0x4cf3 0x47e3 0x38b0 0x528d 0x5403 0x4f20 0x4a70 0x3802 0x537d 0x5464 0x5208 0x4cdb 0x3411 0x53d4 0x548b 0x53f6 0x4e60 0x2d2b 0x534a 0x5461 0x5202 0x4c20 0x2aaf 0x52ab 0x53f5 0x4d12 0x4667 0x2ab9 0x528e 0x5316 0x4ad4 0x4497 0x2ac4 0x5230 0x50ab 0x4a2f 0x45c9 0x2abe 0x4f5e 0x4ea7 0x49f1 0x478f 0x2aa0 0x38f6 0x4e1a 0x49d7 0x49ed 0x2a85 0x2d58 0x4d31 0x4964 0x4bf4 0x2a6d 0x2d43 0x46ce 0x458a 0x48fe 0x2a77 0x2c32 0x463a 0x4372 0x47fa 0x2a69 0x2b7a 0x3ace 0x4377 0x3e2a 0x2a59 0x2b50 0x3b6e 0x42b6 0x4112 0x2a4f 0x2b3b 0x3b50 0x4064 0x42af 0x2a59 0x2b26 0x3e5e 0x3fed 0x4b9d 0x2a7d 0x2b86 0x382a 0x3cbf 0x4be3 0x2aaa 0x2b94 0x373c 0x3d0a 0x4523 0x2a87 0x2b65 0x37c0 0x4127 0x41ae 0x2a60 0x2b3d 0x377a 0x3cf6 0x4504 0x2a26 0x2af3 0x3b3e 0x4aec 0x4d04 0x2a26 0x2af3 0x3b3e 0x4aec 0x4d04 0x2a26 0x2af3 0x3b3e 0x4aec 0x4d04>;
						qcom,lut-row-legend = <0x2710 0x2648 0x2580 0x24b8 0x23f0 0x2328 0x2260 0x2198 0x20d0 0x2008 0x1f40 0x1e78 0x1db0 0x1ce8 0x1c20 0x1b58 0x1a90 0x19c8 0x1900 0x1838 0x1770 0x16a8 0x15e0 0x1518 0x1450 0x1388 0x12c0 0x11f8 0x1130 0x1068 0xfa0 0xed8 0xe10 0xd48 0xc80 0xbb8 0xaf0 0xa28 0x960 0x898 0x7d0 0x708 0x640 0x578 0x4b0 0x3e8 0x384 0x320 0x2bc 0x258 0x1f4 0x190 0x12c 0xc8 0x64 0x0>;
					};

					qcom,pc-temp-z6-lut {
						qcom,lut-col-legend = <0x0 0xa 0x19 0x28 0x32>;
						qcom,lut-data = <0x4285 0x3e1d 0x3b13 0x39d7 0x3983 0x4304 0x3e96 0x3b3d 0x39fc 0x399e 0x42b9 0x3e76 0x3b1b 0x39df 0x398e 0x4251 0x3deb 0x3af2 0x39bc 0x3977 0x41b2 0x3d68 0x3abf 0x39ae 0x396c 0x4105 0x3d0e 0x3a98 0x39a4 0x3965 0x4066 0x3cc8 0x3a82 0x399a 0x395e 0x3fcb 0x3c9f 0x3a72 0x3991 0x3958 0x3f7f 0x3c82 0x3a61 0x3988 0x3952 0x3f74 0x3c6c 0x3a51 0x3980 0x394c 0x3f6e 0x3c5c 0x3a44 0x3978 0x3946 0x3f59 0x3c4e 0x3a39 0x3970 0x3940 0x3f2c 0x3c3e 0x3a31 0x3969 0x393b 0x3f0b 0x3c29 0x3a2b 0x3963 0x3936 0x3f12 0x3c1e 0x3a27 0x395e 0x3932 0x3f26 0x3c23 0x3a23 0x3959 0x392e 0x3f23 0x3c2b 0x3a1c 0x3955 0x3929 0x3ef8 0x3c2a 0x3a12 0x3950 0x3923 0x3ecc 0x3c0c 0x3a0e 0x394e 0x391e 0x3ebf 0x3bf1 0x3a0e 0x394e 0x391d 0x3eb9 0x3c14 0x3a11 0x394f 0x391d 0x3eb7 0x3c78 0x3a43 0x395c 0x3925 0x3edc 0x3cad 0x3a8f 0x398c 0x394c 0x3f28 0x3cb7 0x3a9e 0x39a5 0x3964 0x3f5a 0x3cbd 0x3a90 0x39a1 0x3963 0x3f7b 0x3cb5 0x3a80 0x399a 0x395f 0x3f8e 0x3c97 0x3a74 0x3995 0x395b 0x3f8a 0x3c80 0x3a6a 0x398f 0x3954 0x3f76 0x3c77 0x3a64 0x398a 0x394f 0x3f63 0x3c71 0x3a60 0x3986 0x394a 0x3f4c 0x3c6b 0x3a5e 0x3982 0x3946 0x3f30 0x3c63 0x3a5d 0x397f 0x3943 0x3f24 0x3c5e 0x3a5b 0x397c 0x3941 0x3f1f 0x3c5d 0x3a5a 0x397b 0x393e 0x3f1a 0x3c5d 0x3a59 0x397a 0x393b 0x3f11 0x3c5d 0x3a58 0x397a 0x3939 0x3f05 0x3c5a 0x3a5b 0x397d 0x393c 0x3f02 0x3c57 0x3a5f 0x3985 0x3946 0x3f05 0x3c59 0x3a5f 0x3987 0x3949 0x3f0b 0x3c5e 0x3a5c 0x3985 0x3948 0x3f13 0x3c5e 0x3a58 0x3983 0x3947 0x3f21 0x3c45 0x3a51 0x397e 0x3946 0x3f2b 0x3c39 0x3a4a 0x3978 0x3946 0x3f32 0x3c40 0x3a46 0x3979 0x3948 0x3f22 0x3c30 0x3a3d 0x3974 0x3947 0x3f25 0x3c27 0x3a23 0x3966 0x3933 0x3f28 0x3c26 0x3a1b 0x395c 0x3929 0x3f2c 0x3c29 0x3a13 0x394e 0x391e 0x3f33 0x3c2d 0x3a12 0x3949 0x391a 0x3f41 0x3c41 0x3a21 0x395a 0x3931 0x3f64 0x3c5b 0x3a2c 0x3962 0x3935 0x3f86 0x3c6c 0x3a36 0x3967 0x393a 0x3fac 0x3c89 0x3a40 0x396c 0x3941 0x3fe9 0x3caf 0x3a52 0x397c 0x3950 0x3fe9 0x3caf 0x3a52 0x397c 0x3950 0x3fe9 0x3caf 0x3a52 0x397c 0x3950>;
						qcom,lut-row-legend = <0x2710 0x2648 0x2580 0x24b8 0x23f0 0x2328 0x2260 0x2198 0x20d0 0x2008 0x1f40 0x1e78 0x1db0 0x1ce8 0x1c20 0x1b58 0x1a90 0x19c8 0x1900 0x1838 0x1770 0x16a8 0x15e0 0x1518 0x1450 0x1388 0x12c0 0x11f8 0x1130 0x1068 0xfa0 0xed8 0xe10 0xd48 0xc80 0xbb8 0xaf0 0xa28 0x960 0x898 0x7d0 0x708 0x640 0x578 0x4b0 0x3e8 0x384 0x320 0x2bc 0x258 0x1f4 0x190 0x12c 0xc8 0x64 0x0>;
					};
				};
			};
		};
	};

	fragment@3 {
		target = <0xffffffff>;

		__overlay__ {
			qcom,leds-per-string = <0x7>;
			qcom,string-cfg = <0x3>;
			status = "ok";
		};
	};

	fragment@4 {
		target = <0xffffffff>;

		__overlay__ {
			status = "ok";
		};
	};

	fragment@5 {
		target = <0xffffffff>;

		__overlay__ {
			status = "okay";
		};
	};

	fragment@6 {
		target = <0xffffffff>;

		__overlay__ {
			qcom,battery-data = <0x4>;
			qcom,cl-feedback-on;
			qcom,hold-soc-while-full;
			qcom,linearize-soc;
			qcom,qg-iterm-ma = <0x64>;
		};
	};

	fragment@7 {
		target = <0xffffffff>;

		__overlay__ {
			dpdm-supply = <0xffffffff>;
			io-channel-names = "usb_in_voltage", "usb_in_current", "chg_temp", "die_temp", "conn_temp", "sbux_res", "vph_voltage";
			io-channels = <0xffffffff 0x8 0xffffffff 0x7 0xffffffff 0x9 0xffffffff 0x6 0xffffffff 0x50 0xffffffff 0x99 0xffffffff 0x83>;
			qcom,auto-recharge-soc = <0x62>;
			qcom,battery-data = <0x4>;
			qcom,charger-temp-max = <0x320>;
			qcom,fcc-stepping-enable;
			qcom,sec-charger-config = <0x3>;
			qcom,smb-temp-max = <0x320>;
			qcom,step-charging-enable;
			qcom,suspend-input-on-debug-batt;
			qcom,sw-jeita-enable;
			qcom,thermal-mitigation = <0x401640 0x3567e0 0x2dc6c0 0x2625a0 0x1e8480 0x16e360 0xf4240 0x7a120>;
		};
	};

	fragment@8 {
		target = <0xffffffff>;

		__overlay__ {
			reg = <0x0 0x8f800000 0x0 0x500000>;
		};
	};

	fragment@9 {
		target = <0xffffffff>;

		__overlay__ {
			reg = <0x0 0x8fd00000 0x0 0x3100000>;
		};
	};
};
